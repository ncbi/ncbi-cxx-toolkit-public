/* $Id$
 * ===========================================================================
 *
 *                            PUBLIC DOMAIN NOTICE
 *               National Center for Biotechnology Information
 *
 *  This software/database is a "United States Government Work" under the
 *  terms of the United States Copyright Act.  It was written as part of
 *  the author's official duties as a United States Government employee and
 *  thus cannot be copyrighted.  This software/database is freely available
 *  to the public for use. The National Library of Medicine and the U.S.
 *  Government have not placed any restriction on its use or reproduction.
 *
 *  Although all reasonable efforts have been taken to ensure the accuracy
 *  and reliability of the software and data, the NLM and the U.S.
 *  Government do not and cannot warrant the performance or results that
 *  may be obtained by using this software or data. The NLM and the U.S.
 *  Government disclaim all warranties, express or implied, including
 *  warranties of performance, merchantability or fitness for any particular
 *  purpose.
 *
 *  Please cite the author in any work or product based on this material.
 *
 * ===========================================================================
 *
 * Author:  .......
 *
 * File Description:
 *   .......
 *
 * Remark:
 *   This code was originally generated by application DATATOOL
 *   using the following specifications:
 *   'cache_blob.asn'.
 */

// standard includes
#include <ncbi_pch.hpp>

// generated includes
#include <objtools/data_loaders/asn_cache/Cache_blob.hpp>

#include <corelib/rwstream.hpp>
#include <util/compress/stream.hpp>
#include <util/compress/zlib.hpp>
#include <util/compress/zstd.hpp>

#include "md5_writer.hpp"

#include <serial/serial.hpp>
#include <serial/objostrasnb.hpp>
#include <serial/objistrasnb.hpp>

#include <objects/seqset/Seq_entry.hpp>
#include <strstream>

// generated classes

BEGIN_NCBI_SCOPE

BEGIN_objects_SCOPE // namespace ncbi::objects::

// constructor
CCache_blob::CCache_blob(void)
{
}


// destructor
CCache_blob::~CCache_blob(void)
{
}


void CCache_blob::Pack(const CSeq_entry& entry)
{
    CMD5StreamWriter<TBlob> md5_buffer(SetBlob());

#ifdef HAVE_LIBZSTD
    {{
        CWStream flatten_stream(&md5_buffer);
        CZstdStreamCompressor comp;
        CCompressionOStream compress_stream(flatten_stream, &comp);
        CObjectOStreamAsnBinary asn_stream(compress_stream);
        asn_stream << entry;
        asn_stream.Flush();
        compress_stream.flush();
        md5_buffer.Flush();
    }}
#else
        NCBI_THROW(CException, eUnknown, "This executable can't run, because "
                                         "it compiled without ZSTD library");
#endif

    vector<unsigned char> md5_digest(md5_buffer.GetMD5Sum() );
    vector<char>& blob_md5_digest = SetMd5_digest();
    blob_md5_digest.resize(md5_digest.size());
    memcpy(&blob_md5_digest[0], &md5_digest[0], md5_digest.size());
    SetMagic(kZstdMagicNum);
}


void CCache_blob::UnPack(CSeq_entry& entry) const
{
    const TBlob& raw_data = GetBlob();

    istrstream istr(&raw_data[0], raw_data.size() );

    unique_ptr<CCompressionStreamProcessor> decomp(Decompressor());
    CCompressionIStream decomp_str(istr, decomp.get());
    CObjectIStreamAsnBinary asn_str(decomp_str);
    asn_str >> entry;
}


void CCache_blob::UnPack(vector<unsigned char>& raw_bytes) const
{
    const TBlob& raw_data = GetBlob();

    istrstream istr(&raw_data[0], raw_data.size() );

    unique_ptr<CCompressionStreamProcessor> decomp(Decompressor());
    CCompressionIStream decomp_str(istr, decomp.get());

    raw_bytes.clear();
    raw_bytes.reserve(raw_data.size() * 4);
    unsigned char buf[1024];
    for (;;) {
        decomp_str.read((char*)buf, sizeof(buf));
        size_t size = decomp_str.gcount();
        if ( !size ) {
            break;
        }
        raw_bytes.insert(raw_bytes.end(),
                         buf, buf + size);
    }
}

CCompressionStreamProcessor *CCache_blob::Decompressor() const
{
    switch (GetMagic()) {
    case kZstdMagicNum:
#ifdef HAVE_LIBZSTD
        return new CZstdStreamDecompressor;
#else
        NCBI_THROW(CException, eUnknown, "This executable can't run, because "
                                         "it compiled without ZSTD library");
#endif
    case kGzipMagicNum:
        return new CZipStreamDecompressor;
    default:
        NCBI_THROW(CException, eUnknown, "Blob's magic number not recognized");
    }
}



END_objects_SCOPE // namespace ncbi::objects::

END_NCBI_SCOPE

/* Original file checksum: lines: 57, chars: 1743, CRC32: 66964205 */
