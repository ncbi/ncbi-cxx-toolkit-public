/*  $Id$
 * ===========================================================================
 *
 *                            PUBLIC DOMAIN NOTICE
 *               National Center for Biotechnology Information
 *
 *  This software/database is a "United States Government Work" under the
 *  terms of the United States Copyright Act.  It was written as part of
 *  the author's official duties as a United States Government employee and
 *  thus cannot be copyrighted.  This software/database is freely available
 *  to the public for use. The National Library of Medicine and the U.S.
 *  Government have not placed any restriction on its use or reproduction.
 *
 *  Although all reasonable efforts have been taken to ensure the accuracy
 *  and reliability of the software and data, the NLM and the U.S.
 *  Government do not and cannot warrant the performance or results that
 *  may be obtained by using this software or data. The NLM and the U.S.
 *  Government disclaim all warranties, express or implied, including
 *  warranties of performance, merchantability or fitness for any particular
 *  purpose.
 *
 *  Please cite the author in any work or product based on this material.
 *
 * ===========================================================================
 *
 * Author:  NCBI developers  
 *
 * File Description:
 *   Built-in copy of isolation_sources.txt.
 *
 */

static const char* const k_isolation_sources[] = {
    "abdomen\tabdomen",
    "abdominal fluid\tabdominal fluid",
    "acne\tacne",
    "activated sludge\tactivated sludge",
    "adductor muscle\tadductor muscle",
    "agricultural soil\tagricultural soil",
    "air\tair",
    "amniotic fluid\tamniotic fluid",
    "Animal\tanimal",
    "Animal-Cattle-Beef Cow\tanimal-cattle-beef cow",
    "Animal-Cattle-Dairy Cow\tanimal-cattle-dairy cow",
    "Animal-Cattle-Heifer\tanimal-cattle-heifer",
    "Animal-Cattle-Steer\tanimal-cattle-steer",
    "Animal-Chicken-Young Chicken\tanimal-chicken-young chicken",
    "Animal-Swine-Market Swine\tanimal-swine-market swine",
    "Animal-Swine-Sow\tanimal-swine-sow",
    "antenna\tantenna",
    "aquaculture water\taquaculture water",
    "aquifer sediment\taquifer sediment",
    "aspirate\taspirate",
    "Beef\tbeef",
    "bile\tbile",
    "biofilm\tbiofilm",
    "bitumen\tbitumen",
    "BLOOD\tblood",
    "blood cells\tblood cells",
    "blood sample\tblood sample",
    "Bodily fluid\tbodily fluid",
    "body fluid\tbody fluid",
    "bone\tbone",
    "bone marrow\tbone marrow",
    "Bovine (feces)\tbovine feces",
    "bovine feces\tbovine feces",
    "bovine milk\tbovine milk",
    "Brain\tbrain",
    "brain abscess\tbrain abscess",
    "brain biopsy\tbrain biopsy",
    "brain tissue\tbrain tissue",
    "branch\tbranch",
    "bronchial mucosa\tbronchial mucosa",
    "bronchoalveolar lavage\tbronchoalveolar lavage",
    "buccal epithelial cells\tbuccal epithelial cells",
    "buccal mucosa\tbuccal mucosa",
    "buccal swab\tbuccal swab",
    "buffy coat\tbuffy coat",
    "bursa\tbursa",
    "cabbage leaves\tcabbage leaves",
    "callus\tcallus",
    "catfish\tcatfish",
    "cave sediment\tcave sediment",
    "cave sediments\tcave sediments",
    "cerebellum\tcerebellum",
    "cerebrospinal fluid\tcerebrospinal fluid",
    "cervix\tcervix",
    "Channel catfish\tChannel catfish",
    "cheese\tcheese",
    "Chicken\tchicken",
    "Chicken Breast\tchicken breast",
    "Chicken Carcass\tchicken carcass",
    "Clinical\tclinical",
    "clinical isolate\tclinical isolate",
    "clinical isolates\tclinical isolates",
    "clinical sample\tclinical sample",
    "clinical samples\tclinical samples",
    "cloaca\tcloaca",
    "cloacal swab\tcloacal swab",
    "Comminuted Beef\tcomminuted beef",
    "Comminuted Chicken\tcomminuted chicken",
    "compost\tcompost",
    "compost soil\tcompost soil",
    "coral reef\tcoral reef",
    "corn rhizosphere\tcorn rhizosphere",
    "cornea\tcornea",
    "cotton rhizosphere\tcotton rhizosphere",
    "creek water\tcreek water",
    "crown\tcrown",
    "CSF\tCSF",
    "Cucumbers\tcucumbers",
    "culture\tculture",
    "curd sample\tcurd sample",
    "dairy cow rumen\tdairy cow rumen",
    "dairy farm soil\tdairy farm soil",
    "distillery\tdistillery",
    "drinking water\tdrinking water",
    "ear\tear",
    "egg\tegg",
    "embryogenic callus\tembryogenic callus",
    "Environmental\tenvironmental",
    "environmental sample\tenvironmental sample",
    "Environmental Swab\tenvironmental swab",
    "Environmental Swabs\tenvironmental swabs",
    "Environmental: non-food-contact surface\tenvironmental: non-food-contact surface",
    "epithelium\tepithelium",
    "esophageal mucosa\tesophageal mucosa",
    "estuarine water\testuarine water",
    "estuarine waters\testuarine waters",
    "Excreted bodily substance\texcreted bodily substance",
    "eye\teye",
    "Faeces\tfeces",
    "farm environment\tfarm environment",
    "farm soil\tfarm soil",
    "fecal\tfeces",
    "fecal sample\tfecal sample",
    "fecal samples\tfecal samples",
    "Feces\tfeces",
    "fermented food\tfermented food",
    "fermented soybeans\tfermented soybeans",
    "fetal brain\tfetal brain",
    "field soil\tfield soil",
    "fin\tfin",
    "fin wound\tfin wound",
    "fish eggs\tfish eggs",
    "fish intestine\tfish intestine",
    "flooded rice soil\tflooded rice soil",
    "flower\tflower",
    "Food\tfood",
    "food product\tfood product",
    "food sample\tfood sample",
    "food samples\tfood samples",
    "forest\tforest",
    "forest soil\tforest soil",
    "freshwater\tfreshwater",
    "freshwater stream\tfreshwater stream",
    "fruit\tfruit",
    "fruit body\tfruit body",
    "fruitbody\tfruitbody",
    "fruiting body\tfruiting body",
    "gastric mucosa\tgastric mucosa",
    "gastrointestinal tract\tgastrointestinal tract",
    "genital cells\tgenital cells",
    "genitals\tgenitals",
    "gill\tgill",
    "gills\tgills",
    "goat milk\tgoat milk",
    "Ground Chicken\tground chicken",
    "Ground Turkey\tground turkey",
    "groundwater\tgroundwater",
    "head\thead",
    "head kidney\thead kidney",
    "heart\theart",
    "heart blood\theart blood",
    "hemocyte\themocyte",
    "hepatic bile duct\thepatic bile duct",
    "hepatic biliary duct\thepatic biliary duct",
    "hepatocyte\thepatocyte",
    "hepatopancreas\thepatopancreas",
    "horse\thorse",
    "Hospital\thospital",
    "hot marine salterns\thot marine salterns",
    "hot spring\thot spring",
    "hot springs\thot springs",
    "Human\thuman",
    "human plasma\thuman plasma",
    "human skin\thuman skin",
    "infected leaf\tinfected leaf",
    "inflorescence\tinflorescence",
    "intestinal mucosa\tintestinal mucosa",
    "intestine\tintestine",
    "intestines\tintestines",
    "kidney\tkidney",
    "kimchi\tkimchi",
    "lake\tlake",
    "lake isolate\tlake isolate",
    "lake mud\tlake mud",
    "lake sediment\tlake sediment",
    "lake soil\tlake soil",
    "lake water\tlake water",
    "leaf\tleaf",
    "leaves\tleaves",
    "lentil\tlentil",
    "liver\tliver",
    "liver abscess\tliver abscess",
    "lung\tlung",
    "lymph node\tlymph node",
    "lymphocyte\tlymphocyte",
    "maize\tmaize",
    "mammary gland\tmammary gland",
    "mangrove sediment\tmangrove sediment",
    "mangrove sediments\tmangrove sediments",
    "mangrove soil\tmangrove soil",
    "manure\tmanure",
    "marine environment\tmarine environment",
    "marine sediment\tmarine sediment",
    "marine sediments\tmarine sediments",
    "marine water\tmarine water",
    "mature leaf\tmature leaf",
    "meat\tmeat",
    "midgut\tmidgut",
    "Milk\tmilk",
    "Missing\tmissing",
    "mitral valve\tmitral valve",
    "mouth wound\tmouth wound",
    "mucosa\tmucosa",
    "mucus\tmucus",
    "muscle\tmuscle",
    "muscle tissue\tmuscle tissue",
    "mycelium\tmycelium",
    "Nares\tnares",
    "nasal\tnasal",
    "nasal mucosa\tnasal mucosa",
    "nasal sample\tnasal sample",
    "nasal samples\tnasal samples",
    "nasal swab\tnasal swab",
    "nasopharyngeal aspirate\tnasopharyngeal aspirate",
    "nasopharyngeal swab\tnasopharyngeal swab",
    "nasopharynx\tnasopharynx",
    "nest\tnest",
    "neuroblast\tneuroblast",
    "nodule\tnodule",
    "nodules\tnodules",
    "nose swab\tnose swab",
    "Not Applicable\tnot applicable",
    "Not known\tnot known",
    "olfactory mucosa\tolfactory mucosa",
    "oral fluid\toral fluid",
    "oral lexion\toral lexion",
    "oral mucosa\toral mucosa",
    "Other\tother",
    "ovary\tovary",
    "oviduct\toviduct",
    "paddy soil\tpaddy soil",
    "papaya\tpapaya",
    "parietal cortex\tparietal cortex",
    "patient\tpatient",
    "patient with urinary tract infection\tpatient with urinary tract infection",
    "pericardial\tpericardial",
    "pharnyx\tpharnyx",
    "placenta\tplacenta",
    "plasma\tplasma",
    "pleopod\tpleopod",
    "pleopods\tpleopods",
    "pleura\tpleura",
    "pod\tpod",
    "pond sediment\tpond sediment",
    "pond water\tpond water",
    "porcine Pleural Cavity\tporcine pleural cavity",
    "poultry farm soil\tpoultry farm soil",
    "product-eggs-raw-whole\tproduct-eggs-raw-whole",
    "Product-Raw-Intact-Beef\tproduct-raw-intact-beef",
    "purulent fluid\tpurulent fluid",
    "Raw Intact Chicken\traw intact chicken",
    "Respiratory\trespiratory",
    "Respiratory system\trespiratory system",
    "respiratory tract\trespiratory tract",
    "Retail Deli\tretail deli",
    "Retail Meat\tretail meat",
    "rhizosphere\trhizosphere",
    "rhizosphere soil\trhizosphere soil",
    "rice rhizosphere\trice rhizosphere",
    "rice soil\trice soil",
    "river sand\triver sand",
    "river sediment\triver sediment",
    "river sediments\triver sediments",
    "river water\triver water",
    "root\troot",
    "root nodule\troot nodule",
    "root nodules\troot nodules",
    "root tip\troot tip",
    "root tips\troot tips",
    "roots\troots",
    "rumen\trumen",
    "saline lake\tsaline lake",
    "saliva\tsaliva",
    "salivary gland\tsalivary gland",
    "saltern soil\tsaltern soil",
    "seafood\tseafood",
    "seawater\tseawater",
    "sediment\tsediment",
    "sediments\tsediments",
    "seedling\tseedling",
    "seedling roots\tseedling roots",
    "sera\tsera",
    "serum\tserum",
    "sesame seeds\tsesame seeds",
    "sewage sludge\tsewage sludge",
    "shrimp pond\tshrimp pond",
    "skeletal muscle\tskeletal muscle",
    "skin\tskin",
    "skin lesion\tskin lesion",
    "sludge\tsludge",
    "soda lake\tsoda lake",
    "Soil\tsoil",
    "soil rhizosphere\tsoil rhizosphere",
    "soil sample\tsoil sample",
    "solar saltern\tsolar saltern",
    "solar salterns\tsolar salterns",
    "spindle leaf\tspindle leaf",
    "spleen\tspleen",
    "Sputum\tsputum",
    "stem\tstem",
    "stem base\tstem base",
    "stems\tstems",
    "stomach\tstomach",
    "Stool\tstool",
    "stool sample\tstool sample",
    "stool samples\tstool samples",
    "Stool/Fecal\tstool/fecal",
    "strawberry\tstrawberry",
    "sulphur spring\tsulphur spring",
    "surface water\tsurface water",
    "swab\tswab",
    "swamp soil\tswamp soil",
    "tail\ttail",
    "tannery waste\ttannery waste",
    "tannery waste effluent\ttannery waste effluent",
    "tentacle\ttentacle",
    "testes\ttestes",
    "testis\ttestis",
    "textile wastewater\ttextile wastewater",
    "throat\tthroat",
    "throat swab\tthroat swab",
    "throat wash\tthroat wash",
    "thymus\tthymus",
    "tissue biopsy\ttissue biopsy",
    "trachea\ttrachea",
    "tracheal aspirate\ttracheal aspirate",
    "tracheal swab\ttracheal swab",
    "turfgrass\tturfgrass",
    "twig\ttwig",
    "underground water\tunderground water",
    "Unknown\tunknown",
    "urethra\turethra",
    "Urine\turine",
    "uterine mucosa\tuterine mucosa",
    "vegetable\tvegetable",
    "vegetables\tvegetables",
    "wastewater\twastewater",
    "Water\twater",
    "white clover\twhite clover",
    "whole blood\twhole blood",
    "whole cell/tissue lysate\twhole cell/tissue lysate",
    "WOUND\twound",
    "yogurt\tyogurt"
};
