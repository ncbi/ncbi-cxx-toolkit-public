/*  $Id$
 * ===========================================================================
 *
 *                            PUBLIC DOMAIN NOTICE
 *               National Center for Biotechnology Information
 *
 *  This software/database is a "United States Government Work" under the
 *  terms of the United States Copyright Act.  It was written as part of
 *  the author's official duties as a United States Government employee and
 *  thus cannot be copyrighted.  This software/database is freely available
 *  to the public for use. The National Library of Medicine and the U.S.
 *  Government have not placed any restriction on its use or reproduction.
 *
 *  Although all reasonable efforts have been taken to ensure the accuracy
 *  and reliability of the software and data, the NLM and the U.S.
 *  Government do not and cannot warrant the performance or results that
 *  may be obtained by using this software or data. The NLM and the U.S.
 *  Government disclaim all warranties, express or implied, including
 *  warranties of performance, merchantability or fitness for any particular
 *  purpose.
 *
 *  Please cite the author in any work or product based on this material.
 *
 * ===========================================================================
 *
 * Author:  Jonathan Kans et al.
 *
 * File Description:
 *   Built-in copy of gc.prt.
 *
 */

static const char* const s_GenCodeTblMemStr[] = {
    "",
    "Genetic-code-table ::= {",
    " {",
    "  name \"Standard\" ,",
    "  name \"SGC0\" ,",
    "  id 1 ,",
    "  ncbieaa  \"FFLLSSSSYY**CC*WLLLLPPPPHHQQRRRRIIIMTTTTNNKKSSRRVVVVAAAADDEEGGGG\",",
    "  sncbieaa \"---M------**--*----M---------------M----------------------------\"",
    " },",
    " {",
    "  name \"Vertebrate Mitochondrial\" ,",
    "  name \"SGC1\" ,",
    "  id 2 ,",
    "  ncbieaa  \"FFLLSSSSYY**CCWWLLLLPPPPHHQQRRRRIIMMTTTTNNKKSS**VVVVAAAADDEEGGGG\",",
    "  sncbieaa \"----------**--------------------MMMM----------**---M------------\"",
    " },",
    " {",
    "  name \"Yeast Mitochondrial\" ,",
    "  name \"SGC2\" ,",
    "  id 3 ,",
    "  ncbieaa  \"FFLLSSSSYY**CCWWTTTTPPPPHHQQRRRRIIMMTTTTNNKKSSRRVVVVAAAADDEEGGGG\",",
    "  sncbieaa \"----------**----------------------MM---------------M------------\"",
    " },",
    " {",
    "    name \"Mold Mitochondrial; Protozoan Mitochondrial; Coelenterate",
    " Mitochondrial; Mycoplasma; Spiroplasma\" ,",
    "  name \"SGC3\" ,",
    "  id 4 ,",
    "  ncbieaa  \"FFLLSSSSYY**CCWWLLLLPPPPHHQQRRRRIIIMTTTTNNKKSSRRVVVVAAAADDEEGGGG\",",
    "  sncbieaa \"--MM------**-------M------------MMMM---------------M------------\"",
    " },",
    " {",
    "  name \"Invertebrate Mitochondrial\" ,",
    "  name \"SGC4\" ,",
    "  id 5 ,",
    "  ncbieaa  \"FFLLSSSSYY**CCWWLLLLPPPPHHQQRRRRIIMMTTTTNNKKSSSSVVVVAAAADDEEGGGG\",",
    "  sncbieaa \"---M------**--------------------MMMM---------------M------------\"",
    " },",
    " {",
    "  name \"Ciliate Nuclear; Dasycladacean Nuclear; Hexamita Nuclear\" ,",
    "  name \"SGC5\" ,",
    "  id 6 ,",
    "  ncbieaa  \"FFLLSSSSYYQQCC*WLLLLPPPPHHQQRRRRIIIMTTTTNNKKSSRRVVVVAAAADDEEGGGG\",",
    "  sncbieaa \"--------------*--------------------M----------------------------\"",
    " },",
    " {",
    "  name \"Echinoderm Mitochondrial; Flatworm Mitochondrial\" ,",
    "  name \"SGC8\" ,",
    "  id 9 ,",
    "  ncbieaa  \"FFLLSSSSYY**CCWWLLLLPPPPHHQQRRRRIIIMTTTTNNNKSSSSVVVVAAAADDEEGGGG\",",
    "  sncbieaa \"----------**-----------------------M---------------M------------\"",
    " },",
    " {",
    "  name \"Euplotid Nuclear\" ,",
    "  name \"SGC9\" ,",
    "  id 10 ,",
    "  ncbieaa  \"FFLLSSSSYY**CCCWLLLLPPPPHHQQRRRRIIIMTTTTNNKKSSRRVVVVAAAADDEEGGGG\",",
    "  sncbieaa \"----------**-----------------------M----------------------------\"",
    " },",
    " {",
    "  name \"Bacterial, Archaeal and Plant Plastid\" ,",
    "  id 11 ,",
    "  ncbieaa  \"FFLLSSSSYY**CC*WLLLLPPPPHHQQRRRRIIIMTTTTNNKKSSRRVVVVAAAADDEEGGGG\",",
    "  sncbieaa \"---M------**--*----M------------MMMM---------------M------------\"",
    " },",
    " {",
    "  name \"Alternative Yeast Nuclear\" ,",
    "  id 12 ,",
    "  ncbieaa  \"FFLLSSSSYY**CC*WLLLSPPPPHHQQRRRRIIIMTTTTNNKKSSRRVVVVAAAADDEEGGGG\",",
    "  sncbieaa \"----------**--*----M---------------M----------------------------\"",
    " },",
    " {",
    "  name \"Ascidian Mitochondrial\" ,",
    "  id 13 ,",
    "  ncbieaa  \"FFLLSSSSYY**CCWWLLLLPPPPHHQQRRRRIIMMTTTTNNKKSSGGVVVVAAAADDEEGGGG\",",
    "  sncbieaa \"---M------**----------------------MM---------------M------------\"",
    " },",
    " {",
    "  name \"Alternative Flatworm Mitochondrial\" ,",
    "  id 14 ,",
    "  ncbieaa  \"FFLLSSSSYYY*CCWWLLLLPPPPHHQQRRRRIIIMTTTTNNNKSSSSVVVVAAAADDEEGGGG\",",
    "  sncbieaa \"-----------*-----------------------M----------------------------\"",
    " } ,",
    " {",
    "  name \"Blepharisma Macronuclear\" ,",
    "  id 15 ,",
    "  ncbieaa  \"FFLLSSSSYY*QCC*WLLLLPPPPHHQQRRRRIIIMTTTTNNKKSSRRVVVVAAAADDEEGGGG\",",
    "  sncbieaa \"----------*---*--------------------M----------------------------\"",
    " } ,",
    " {",
    "  name \"Chlorophycean Mitochondrial\" ,",
    "  id 16 ,",
    "  ncbieaa  \"FFLLSSSSYY*LCC*WLLLLPPPPHHQQRRRRIIIMTTTTNNKKSSRRVVVVAAAADDEEGGGG\",",
    "  sncbieaa \"----------*---*--------------------M----------------------------\"",
    " } ,",
    " {",
    "  name \"Trematode Mitochondrial\" ,",
    "  id 21 ,",
    "  ncbieaa  \"FFLLSSSSYY**CCWWLLLLPPPPHHQQRRRRIIMMTTTTNNNKSSSSVVVVAAAADDEEGGGG\",",
    "  sncbieaa \"----------**-----------------------M---------------M------------\"",
    " } ,",
    " {",
    "  name \"Scenedesmus obliquus Mitochondrial\" ,",
    "  id 22 ,",
    "  ncbieaa  \"FFLLSS*SYY*LCC*WLLLLPPPPHHQQRRRRIIIMTTTTNNKKSSRRVVVVAAAADDEEGGGG\",",
    "  sncbieaa \"------*---*---*--------------------M----------------------------\"",
    " } ,",
    " {",
    "  name \"Thraustochytrium Mitochondrial\" ,",
    "  id 23 ,",
    "  ncbieaa  \"FF*LSSSSYY**CC*WLLLLPPPPHHQQRRRRIIIMTTTTNNKKSSRRVVVVAAAADDEEGGGG\",",
    "  sncbieaa \"--*-------**--*-----------------M--M---------------M------------\"",
    " } ,",
    " {",
    "  name \"Rhabdopleuridae Mitochondrial\" ,",
    "  id 24 ,",
    "  ncbieaa  \"FFLLSSSSYY**CCWWLLLLPPPPHHQQRRRRIIIMTTTTNNKKSSSKVVVVAAAADDEEGGGG\",",
    "  sncbieaa \"---M------**-------M---------------M---------------M------------\"",
    " } ,",
    " {",
    "  name \"Candidate Division SR1 and Gracilibacteria\" ,",
    "  id 25 ,",
    "  ncbieaa  \"FFLLSSSSYY**CCGWLLLLPPPPHHQQRRRRIIIMTTTTNNKKSSRRVVVVAAAADDEEGGGG\",",
    "  sncbieaa \"---M------**-----------------------M---------------M------------\"",
    " } ,",
    " {",
    "  name \"Pachysolen tannophilus Nuclear\" ,",
    "  id 26 ,",
    "  ncbieaa  \"FFLLSSSSYY**CC*WLLLAPPPPHHQQRRRRIIIMTTTTNNKKSSRRVVVVAAAADDEEGGGG\",",
    "  sncbieaa \"----------**--*----M---------------M----------------------------\"",
    " } ,",
    " {",
    "  name \"Karyorelict Nuclear\" ,",
    "  id 27 ,",
    "  ncbieaa  \"FFLLSSSSYYQQCCWWLLLLPPPPHHQQRRRRIIIMTTTTNNKKSSRRVVVVAAAADDEEGGGG\",",
    "  sncbieaa \"--------------*--------------------M----------------------------\"",
    " } ,",
    " {",
    "  name \"Condylostoma Nuclear\" ,",
    "  id 28 ,",
    "  ncbieaa  \"FFLLSSSSYYQQCCWWLLLLPPPPHHQQRRRRIIIMTTTTNNKKSSRRVVVVAAAADDEEGGGG\",",
    "  sncbieaa \"----------**--*--------------------M----------------------------\"",
    " } ,",
    " {",
    "  name \"Mesodinium Nuclear\" ,",
    "  id 29 ,",
    "  ncbieaa  \"FFLLSSSSYYYYCC*WLLLLPPPPHHQQRRRRIIIMTTTTNNKKSSRRVVVVAAAADDEEGGGG\",",
    "  sncbieaa \"--------------*--------------------M----------------------------\"",
    " } ,",
    " {",
    "  name \"Peritrich Nuclear\" ,",
    "  id 30 ,",
    "  ncbieaa  \"FFLLSSSSYYEECC*WLLLLPPPPHHQQRRRRIIIMTTTTNNKKSSRRVVVVAAAADDEEGGGG\",",
    "  sncbieaa \"--------------*--------------------M----------------------------\"",
    " } ,",
    " {",
    "  name \"Blastocrithidia Nuclear\" ,",
    "  id 31 ,",
    "  ncbieaa  \"FFLLSSSSYYEECCWWLLLLPPPPHHQQRRRRIIIMTTTTNNKKSSRRVVVVAAAADDEEGGGG\",",
    "  sncbieaa \"----------**-----------------------M----------------------------\"",
    " } ,",
    " {",
    "  name \"Balanophoraceae Plastid\" ,",
    "  id 32 ,",
    "  ncbieaa  \"FFLLSSSSYY*WCC*WLLLLPPPPHHQQRRRRIIIMTTTTNNKKSSRRVVVVAAAADDEEGGGG\",",
    "  sncbieaa \"---M------*---*----M------------MMMM---------------M------------\"",
    " } ,",
    " {",
    "  name \"Cephalodiscidae Mitochondrial\" ,",
    "  id 33 ,",
    "  ncbieaa  \"FFLLSSSSYYY*CCWWLLLLPPPPHHQQRRRRIIIMTTTTNNKKSSSKVVVVAAAADDEEGGGG\",",
    "  sncbieaa \"---M-------*-------M---------------M---------------M------------\"",
    " }",
    "}"
};

