/*  $Id$
 * ===========================================================================
 *
 *                            PUBLIC DOMAIN NOTICE
 *               National Center for Biotechnology Information
 *
 *  This software/database is a "United States Government Work" under the
 *  terms of the United States Copyright Act.  It was written as part of
 *  the author's official duties as a United States Government employee and
 *  thus cannot be copyrighted.  This software/database is freely available
 *  to the public for use. The National Library of Medicine and the U.S.
 *  Government have not placed any restriction on its use or reproduction.
 *
 *  Although all reasonable efforts have been taken to ensure the accuracy
 *  and reliability of the software and data, the NLM and the U.S.
 *  Government do not and cannot warrant the performance or results that
 *  may be obtained by using this software or data. The NLM and the U.S.
 *  Government disclaim all warranties, express or implied, including
 *  warranties of performance, merchantability or fitness for any particular
 *  purpose.
 *
 *  Please cite the author in any work or product based on this material.
 *
 * ===========================================================================
 *
 * Author:  Jonathan Kans et al.
 *
 * File Description:
 *   Built-in copy of lat_lon_island.txt.
 *
 */

static const char* const s_DefaultLatLonisLandText[] = {
    "- Made with Natural Earth.",
    "1",
    "Unnamed Islands",
    "	82	53	55",
    "	81	-68	-65	53	55",
    "	80	-68	-65	53	55",
    "	79	-68	-65",
    "	78	89	91",
    "	77	89	91	96	98",
    "	76	89	93	96	98",
    "	75	91	93	96	98",
    "	74	91	93",
    "	72	23	26",
    "	71	17	26	30	32",
    "	70	17	26	29	32",
    "	69	13	26	29	32	36	39	66	68",
    "	68	-175	-173	10	22	29	33	36	41	66	68",
    "	67	-175	-173	-18	-16	10	17	31	34	36	41	66	68",
    "	66	-175	-173	-24	-21	-18	-16	10	16	20	26	31	36	39	41",
    "	65	-173	-171	-167	-165	-24	-20	-18	-13	8	14	20	26	32	37	39	41",
    "	64	-173	-171	-167	-163	-24	-13	7	13	17	26	33	37",
    "	63	-173	-171	-167	-163	-23	-13	4	12	16	26	33	37",
    "	62	-167	-163	-21	-15	3	12	16	24",
    "	61	-167	-163	-147	-143	-79	-76	3	7	16	29",
    "	60	-167	-164	-147	-143	-81	-76	-6	-4	3	6	9	11	16	29",
    "	59	-161	-158	-153	-151	-147	-143	-81	-76	-6	-4	3	7	9	12	15	29",
    "	58	-161	-155	-153	-151	-145	-143	-81	-75	-6	-4	3	7	9	12	15	24	26	28",
    "	57	-161	-151	-81	-75	5	7	9	19	21	23",
    "	56	-164	-153	-80	-75	9	17",
    "	55	-166	-157	-155	-153	-134	-132	-80	-75	-5	-3	7	16",
    "	54	-169	-159	-134	-131	-80	-77	-11	-3	5	16",
    "	53	-176	-174	-172	-160	-134	-130	-80	-77	-11	-3	5	12",
    "	52	-180	-174	-172	-167	-134	-130	-80	-77	-11	-3	5	7",
    "	51	-180	-174	-172	-167	-132	-130	-128	-123	-80	-77	-10	-8	-6	-3",
    "	50	-180	-174	-128	-122	-80	-78	-10	-1",
    "	49	-128	-121	-7	-5	-3	0",
    "	48	-127	-121	-62	-59	-7	-5	-3	0",
    "	47	-126	-121	-62	-59	-2	0	51	54	140	142",
    "	46	-62	-59	11	13	46	49	51	54	140	142",
    "	45	11	16	46	54	140	142",
    "	44	5	17	46	51	140	142	144	147",
    "	43	5	18	46	51	129	133	140	142	144	147",
    "	42	5	12	14	18	129	133	138	140	144	147",
    "	41	-9	-7	8	20	22	24	27	30	119	121	127	133	138	140",
    "	40	-10	-7	8	15	18	25	27	30	119	129	138	140",
    "	39	-10	-7	8	15	18	30	119	129	138	142",
    "	38	-124	-121	-10	-6	7	11	18	28	120	129	138	142",
    "	37	-124	-121	-10	-6	7	11	13	15	20	30	32	34	120	127	138	142",
    "	36	-124	-121	-8	-6	7	11	13	15	20	30	32	34	119	129	138	140",
    "	35	-120	-118	-8	-6	13	15	21	30	32	34	118	121	124	136	138	140",
    "	34	-120	-118	24	27	118	121	124	136	138	140",
    "	33	-120	-118	-65	-63	24	27	118	121	124	136	138	140",
    "	32	-120	-118	-65	-63	119	121	125	136	138	140",
    "	31	-89	-87	-65	-63	48	50	119	123	127	133",
    "	30	-91	-87	-83	-81	48	50	120	123	127	132",
    "	29	-91	-87	-83	-81	48	50	120	123	128	131",
    "	28	-176	-174	-91	-87	-83	-81	-79	-77	34	36	120	123	128	130	141	143",
    "	27	-176	-174	-83	-75	34	36	54	56	118	122	126	130	141	143",
    "	26	-176	-174	-82	-75	34	36	51	56	118	128	141	143",
    "	25	-83	-75	36	38	50	56	117	128",
    "	24	-167	-160	-83	-76	34	38	50	56	115	126",
    "	23	-167	-160	-92	-88	-85	-74	34	38	50	56	112	126",
    "	22	-167	-160	-92	-74	34	37	106	109	112	122",
    "	21	-93	-73	35	38	105	109	112	114	119	122",
    "	20	-93	-90	-87	-73	-17	-15	36	38	104	109	112	114	120	122",
    "	19	-93	-87	-79	-73	-65	-62	-17	-15	36	38	104	108	120	123",
    "	18	-89	-86	-84	-82	-65	-62	-17	-15	104	106	120	123",
    "	17	-89	-86	-84	-82	-65	-60	40	42	110	113	118	123",
    "	16	-89	-77	-62	-60	39	43	94	96	107	113	118	120",
    "	15	-89	-77	-62	-60	39	43	92	98	107	113	118	124	167	170",
    "	14	-87	-77	-62	-60	39	43	91	99	107	110	119	125	167	170",
    "	13	-84	-81	-62	-60	39	44	91	94	96	101	108	110	119	126	167	171",
    "	12	-83	-81	-68	-60	41	44	91	94	96	103	108	110	118	126	161	171",
    "	11	-83	-81	-68	-60	41	44	91	94	96	103	113	115	118	126	161	171",
    "	10	-68	-60	42	44	78	80	91	93	96	105	113	126	159	171",
    "	9	-66	-60	78	80	92	94	96	100	102	105	112	126	153	155	159	161	164	172",
    "	8	78	80	92	94	96	100	102	105	112	119	124	126	142	144	148	150	153	155	159	161	164	172",
    "	7	78	80	92	94	96	100	103	105	112	126	142	144	148	150	153	155	164	172",
    "	6	-163	-161	97	104	116	126	142	144	148	150	167	172",
    "	5	-163	-161	98	104	106	109	116	126	168	172",
    "	4	-163	-161	-82	-80	99	109	116	122	124	126	168	170",
    "	3	-82	-80	95	97	99	110	117	121	124	126",
    "	2	-82	-80	95	97	99	110	123	125",
    "	1	95	110	121	125	128	132	172	175",
    "	0	96	100	102	109	121	132	134	138	172	175",
    "	-1	96	100	102	111	115	117	121	138	146	148	172	175",
    "	-2	98	117	122	138	142	144	146	148",
    "	-3	99	102	104	117	120	124	129	136	142	144	146	148	151	160",
    "	-4	99	102	104	125	129	135	142	144	151	160",
    "	-5	100	102	104	107	109	111	113	125	130	135	151	160",
    "	-6	104	107	109	126	128	135	154	160	176	179",
    "	-7	104	106	112	122	124	135	142	144	149	151	154	161	176	180",
    "	-8	-172	-170	-159	-156	-151	-149	104	106	112	122	124	135	141	145	149	152	158	161	166	168	176	180",
    "	-9	-172	-170	-166	-164	-159	-156	-151	-149	50	52	115	133	141	145	149	153	158	168	177	180",
    "	-10	-172	-170	-166	-164	-159	-156	-151	-149	46	48	50	52	119	123	131	137	141	145	149	154	160	168	178	180",
    "	-11	-166	-164	-151	-149	46	48	50	52	119	124	129	137	141	145	149	154	160	166	178	180",
    "	-12	-166	-162	46	48	121	127	129	137	142	145	151	154",
    "	-13	-179	-176	-164	-162	122	132	135	137	142	146",
    "	-14	-180	-176	-174	-172	-164	-162	53	55	122	130	135	137	143	146",
    "	-15	-180	-176	-174	-172	53	55	58	60	122	130	135	137	143	151",
    "	-16	-180	-178	-174	-172	53	55	58	60	122	125	135	137	144	151",
    "	-17	-160	-158	58	60	122	125	144	151",
    "	-18	-176	-174	-160	-157	145	149	157	159",
    "	-19	-176	-173	-160	-157	145	150	157	159",
    "	-20	-176	-173	-159	-157	-155	-153	38	40	147	159",
    "	-21	-175	-173	-155	-153	38	40	147	156",
    "	-22	-155	-153	38	40	148	156",
    "	-23	148	156",
    "	-24	149	151",
    "	-37	-74	-72",
    "	-38	-74	-72	146	148",
    "	-39	-74	-72	146	148	173	175",
    "	-40	146	148	173	175",
    "	-41	173	175",
    "	-44	165	167",
    "	-45	165	169",
    "	-46	165	169	178	180",
    "	-47	165	169	178	180",
    "	-48	166	168	178	180",
    "	-50	-62	-58",
    "	-51	-62	-58",
    "	-52	-62	-58	-43	-40",
    "	-53	-60	-58	-43	-40	-35	-33",
    "	-54	-43	-40	-35	-33",
    "	-55	-69	-67	-35	-33",
    "	-56	-69	-67	-35	-33",
    "	-57	-69	-67",
    "	-75	167	169",
    "	-76	167	169",
    "	-77	167	169",
    "Unnamed Reefs",
    "	29	-179	-176",
    "	28	-179	-174	-79	-77",
    "	27	-179	-174	-79	-75	35	37	49	52",
    "	26	-177	-174	-171	-169	-79	-75	35	37	49	52",
    "	25	-171	-169	-78	-75	35	39	49	52",
    "	24	-171	-169	-167	-165	-78	-75	35	39	50	52",
    "	23	-167	-165	-85	-83	36	40	50	52",
    "	22	-167	-165	-85	-80	-78	-75	36	40",
    "	21	-85	-75	37	41	115	117	135	137",
    "	20	-82	-75	37	41	115	117	135	137	165	167",
    "	19	-79	-76	38	42	115	117	135	137	165	167",
    "	18	-89	-86	39	43	110	112	165	167",
    "	17	-170	-168	-89	-86	39	43	110	113",
    "	16	-170	-168	-89	-86	-80	-77	40	43	110	113",
    "	15	-170	-168	-89	-86	-80	-77	40	44	110	113	167	170",
    "	14	-80	-77	40	44	167	170",
    "	13	41	44	70	72	167	171",
    "	12	70	73	113	115	161	171",
    "	11	70	73	112	115	138	140	161	171",
    "	10	70	73	112	116	138	140	144	146	159	171",
    "	9	71	74	110	116	133	141	143	155	159	161	164	172",
    "	8	71	74	110	116	133	156	159	161	164	172",
    "	7	-163	-161	71	74	110	116	133	158	164	173",
    "	6	-163	-161	71	74	111	114	133	135	142	158	167	173",
    "	5	-163	-161	71	74	111	114	142	144	148	150	152	154	156	158	167	173",
    "	4	-163	-161	71	74	111	113	152	154	156	158	167	173",
    "	3	71	74	171	173",
    "	2	71	74	171	173",
    "	1	71	74	144	146	171	175",
    "	0	71	74	143	150	152	154	171	175",
    "	-1	-172	-170	71	74	143	154	171	175",
    "	-2	-175	-169	143	154	173	175",
    "	-3	-175	-169	144	160",
    "	-4	-175	-169	71	73	144	160	175	177",
    "	-5	-173	-170	71	73	144	160	175	177",
    "	-6	71	73	144	151	153	160	175	179",
    "	-7	-173	-171	-158	-156	71	73	145	163	176	180",
    "	-8	-173	-170	-162	-156	-151	-149	50	52	71	73	141	163	176	180",
    "	-9	-180	-175	-173	-170	-166	-164	-162	-156	-151	-149	50	52	55	57	141	167	177	180",
    "	-10	-180	-175	-172	-170	-166	-164	-162	-156	-151	-149	50	52	55	57	141	156	158	167	178	180",
    "	-11	-180	-175	-166	-164	-162	-159	-151	-149	50	52	55	57	141	156	158	167	176	180",
    "	-12	-180	-175	-173	-170	-166	-162	124	127	142	147	150	155	158	161	165	168	176	178",
    "	-13	-177	-175	-173	-170	-164	-162	-149	-137	124	127	142	147	159	161	165	168	176	178",
    "	-14	-177	-175	-173	-170	-164	-162	-155	-153	-149	-137	122	127	142	147	159	161	165	168",
    "	-15	-180	-178	-155	-137	58	60	122	126	143	149	166	169	176	180",
    "	-16	-180	-177	-164	-162	-155	-137	58	60	117	120	122	124	144	149	161	163	166	169	175	180",
    "	-17	-180	-177	-175	-173	-164	-162	-160	-158	-155	-135	58	60	117	120	144	149	157	159	161	169	175	180",
    "	-18	-180	-177	-175	-173	-168	-166	-164	-162	-160	-157	-151	-148	-146	-135	56	58	62	64	117	120	145	150	157	166	168	171	175	180",
    "	-19	-180	-173	-168	-166	-164	-157	-146	-135	56	58	62	64	118	120	145	153	157	171	176	180",
    "	-20	-180	-173	-168	-166	-162	-157	-155	-153	-146	-134	54	58	62	64	118	120	147	153	157	160	162	171	176	180",
    "	-21	-179	-173	-168	-166	-162	-159	-155	-150	-144	-134	54	58	149	153	157	160	162	170",
    "	-22	-176	-173	-155	-146	-141	-133	54	56	149	153	157	160	163	169",
    "	-23	-153	-146	-139	-133	-125	-123	150	153	164	168",
    "	-24	-150	-146	-138	-133	-125	-123	150	153	165	168",
    "	-25	-125	-123",
    "	-27	112	115",
    "	-28	112	115	158	160",
    "	-29	112	115	158	160",
    "	-30	112	114	158	160"
};
