  { "AFTOL",               { CDbtag::fGenBank | CDbtag::fSrc, CDbtag::eDbtagType_AFTOL } },
  { "APHIDBASE",           { CDbtag::fGenBank, CDbtag::eDbtagType_APHIDBASE } },
  { "ASAP",                { CDbtag::fGenBank, CDbtag::eDbtagType_ASAP } },
  { "ATCC",                { CDbtag::fGenBank | CDbtag::fSrc, CDbtag::eDbtagType_ATCC } },
  { "ATCC(dna)",           { CDbtag::fGenBank | CDbtag::fSrc, CDbtag::eDbtagType_ATCC_dna } },
  { "ATCC(in host)",       { CDbtag::fGenBank | CDbtag::fSrc, CDbtag::eDbtagType_ATCC_in_host } },
  { "AceView/WormGenes",   { CDbtag::fGenBank, CDbtag::eDbtagType_AceView_WormGenes } },
  { "AntWeb",              { CDbtag::fGenBank | CDbtag::fSrc, CDbtag::eDbtagType_AntWeb } },
  { "ApiDB",               { CDbtag::fGenBank, CDbtag::eDbtagType_ApiDB } },
  { "ApiDB_CryptoDB",      { CDbtag::fGenBank, CDbtag::eDbtagType_ApiDB_CryptoDB } },
  { "ApiDB_PlasmoDB",      { CDbtag::fGenBank, CDbtag::eDbtagType_ApiDB_PlasmoDB } },
  { "ApiDB_ToxoDB",        { CDbtag::fGenBank, CDbtag::eDbtagType_ApiDB_ToxoDB } },
  { "Araport",             { CDbtag::fGenBank, CDbtag::eDbtagType_Araport } },
  { "Axeldb",              { CDbtag::fGenBank, CDbtag::eDbtagType_axeldb } },
  { "BDGP_EST",            { CDbtag::fGenBank, CDbtag::eDbtagType_BDGP_EST } },
  { "BDGP_INS",            { CDbtag::fGenBank, CDbtag::eDbtagType_BDGP_INS } },
  { "BEEBASE",             { CDbtag::fGenBank, CDbtag::eDbtagType_BEEBASE } },
  { "BEETLEBASE",          { CDbtag::fGenBank, CDbtag::eDbtagType_BEETLEBASE } },
  { "BEI",                 { CDbtag::fGenBank | CDbtag::fSrc, CDbtag::eDbtagType_BEI } },
  { "BGD",                 { CDbtag::fGenBank, CDbtag::eDbtagType_BGD } },
  { "BOLD",                { CDbtag::fGenBank | CDbtag::fSrc, CDbtag::eDbtagType_BoLD } },
  { "CDD",                 { CDbtag::fGenBank, CDbtag::eDbtagType_CDD } },
  { "CGD",                 { CDbtag::fGenBank, CDbtag::eDbtagType_CGD } },
  { "CK",                  { CDbtag::fGenBank, CDbtag::eDbtagType_CK } },
  { "COG",                 { CDbtag::fGenBank, CDbtag::eDbtagType_COG } },
  { "ECOCYC",              { CDbtag::fGenBank, CDbtag::eDbtagType_ECOCYC } },
  { "ERIC",                { CDbtag::fGenBank, CDbtag::eDbtagType_ERIC } },
  { "ESTLIB",              { CDbtag::fGenBank, CDbtag::eDbtagType_ESTLIB } },
  { "EchinoBase",          { CDbtag::fRefSeq, CDbtag::eDbtagType_EchinoBase } },
  { "EcoGene",             { CDbtag::fGenBank, CDbtag::eDbtagType_EcoGene } },
  { "EnsemblGenomes",      { CDbtag::fGenBank, CDbtag::eDbtagType_EnsemblGenomes } },
  { "EnsemblGenomes-Gn",   { CDbtag::fGenBank, CDbtag::eDbtagType_EnsemblGenomes_Gn } },
  { "EnsemblGenomes-Tr",   { CDbtag::fGenBank, CDbtag::eDbtagType_EnsemblGenomes_Tr } },
  { "EnsemblRapid",        { CDbtag::fRefSeq, CDbtag::eDbtagType_EnsemblRapid } },
  { "FANTOM_DB",           { CDbtag::fGenBank | CDbtag::fSrc, CDbtag::eDbtagType_FANTOM_DB } },
  { "FBOL",                { CDbtag::fGenBank | CDbtag::fSrc, CDbtag::eDbtagType_FBOL } },
  { "FLYBASE",             { CDbtag::fGenBank | CDbtag::fSrc, CDbtag::eDbtagType_FLYBASE } },
  { "GABI",                { CDbtag::fGenBank, CDbtag::eDbtagType_GABI } },
  { "GDB",                 { CDbtag::fGenBank, CDbtag::eDbtagType_GDB } },
  { "GO",                  { CDbtag::fGenBank, CDbtag::eDbtagType_GO } },
  { "GOA",                 { CDbtag::fGenBank, CDbtag::eDbtagType_GOA } },
  { "GRIN",                { CDbtag::fGenBank | CDbtag::fSrc, CDbtag::eDbtagType_GRIN } },
  { "GeneDB",              { CDbtag::fGenBank, CDbtag::eDbtagType_GeneDB } },
  { "GeneID",              { CDbtag::fGenBank, CDbtag::eDbtagType_GeneID } },
  { "Greengenes",          { CDbtag::fGenBank | CDbtag::fSrc, CDbtag::eDbtagType_Greengenes } },
  { "H-InvDB",             { CDbtag::fGenBank, CDbtag::eDbtagType_H_InvDB } },
  { "HGNC",                { CDbtag::fGenBank, CDbtag::eDbtagType_HGNC } },
  { "HMP",                 { CDbtag::fGenBank | CDbtag::fSrc, CDbtag::eDbtagType_HMP } },
  { "HOMD",                { CDbtag::fGenBank | CDbtag::fSrc, CDbtag::eDbtagType_HOMD } },
  { "HSSP",                { CDbtag::fGenBank, CDbtag::eDbtagType_HSSP } },
  { "I5KNAL",              { CDbtag::fGenBank, CDbtag::eDbtagType_I5KNAL } },
  { "IKMC",                { CDbtag::fGenBank | CDbtag::fSrc, CDbtag::eDbtagType_IKMC } },
  { "IMGT/GENE-DB",        { CDbtag::fGenBank, CDbtag::eDbtagType_IMGT_GENEDB } },
  { "IMGT/HLA",            { CDbtag::fGenBank | CDbtag::fSrc, CDbtag::eDbtagType_IMGT_HLA } },
  { "IMGT/LIGM",           { CDbtag::fGenBank | CDbtag::fSrc, CDbtag::eDbtagType_IMGT_LIGM } },
  { "IRD",                 { CDbtag::fGenBank, CDbtag::eDbtagType_IRD } },
  { "ISD",                 { CDbtag::fGenBank, CDbtag::eDbtagType_ISD } },
  { "ISFinder",            { CDbtag::fGenBank, CDbtag::eDbtagType_ISFinder } },
  { "ISHAM-ITS",           { CDbtag::fGenBank | CDbtag::fSrc, CDbtag::eDbtagType_ISHAM_ITS } },
  { "InterPro",            { CDbtag::fGenBank, CDbtag::eDbtagType_Interpro } },
  { "InterimID",           { CDbtag::fGenBank, CDbtag::eDbtagType_InterimID } },
  { "IntrepidBio",         { CDbtag::fGenBank, CDbtag::eDbtagType_IntrepidBio } },
  { "JCM",                 { CDbtag::fGenBank | CDbtag::fSrc, CDbtag::eDbtagType_JCM } },
  { "JGIDB",               { CDbtag::fGenBank, CDbtag::eDbtagType_JGIDB } },
  { "LocusID",             { CDbtag::fGenBank, CDbtag::eDbtagType_LocusID } },
  { "MGI",                 { CDbtag::fGenBank | CDbtag::fSrc, CDbtag::eDbtagType_MGI } },
  { "MIM",                 { CDbtag::fGenBank, CDbtag::eDbtagType_MIM } },
  { "MaizeGDB",            { CDbtag::fGenBank, CDbtag::eDbtagType_MaizeGDB } },
  { "MarpolBase",          { CDbtag::fGenBank, CDbtag::eDbtagType_MarpolBase } },
  { "MedGen",              { CDbtag::fGenBank, CDbtag::eDbtagType_MedGen } },
  { "MycoBank",            { CDbtag::fGenBank | CDbtag::fSrc, CDbtag::eDbtagType_MycoBank } },
  { "NBRC",                { CDbtag::fGenBank | CDbtag::fSrc, CDbtag::eDbtagType_IFO } },
  { "NMPDR",               { CDbtag::fGenBank, CDbtag::eDbtagType_NMPDR } },
  { "NRESTdb",             { CDbtag::fGenBank, CDbtag::eDbtagType_NRESTdb } },
  { "NextDB",              { CDbtag::fGenBank, CDbtag::eDbtagType_NextDB } },
  { "OrthoMCL",            { CDbtag::fGenBank, CDbtag::eDbtagType_OrthoMCL } },
  { "Osa1",                { CDbtag::fGenBank, CDbtag::eDbtagType_Osa1 } },
  { "PBmice",              { CDbtag::fGenBank, CDbtag::eDbtagType_PBmice } },
  { "PDB",                 { CDbtag::fGenBank, CDbtag::eDbtagType_PDB } },
  { "PFAM",                { CDbtag::fGenBank, CDbtag::eDbtagType_PFAM } },
  { "PGN",                 { CDbtag::fGenBank, CDbtag::eDbtagType_PGN } },
  { "PIR",                 { CDbtag::fGenBank, CDbtag::eDbtagType_PIR } },
  { "PSEUDO",              { CDbtag::fGenBank, CDbtag::eDbtagType_PSEUDO } },
  { "Pathema",             { CDbtag::fGenBank, CDbtag::eDbtagType_Pathema } },
  { "PeptideAtlas",        { CDbtag::fRefSeq, CDbtag::eDbtagType_PeptideAtlas } },
  { "Phytozome",           { CDbtag::fGenBank, CDbtag::eDbtagType_Phytozome } },
  { "PomBase",             { CDbtag::fGenBank, CDbtag::eDbtagType_PomBase } },
  { "RAP-DB",              { CDbtag::fGenBank, CDbtag::eDbtagType_RAP_DB } },
  { "RATMAP",              { CDbtag::fGenBank, CDbtag::eDbtagType_RATMAP } },
  { "RFAM",                { CDbtag::fGenBank, CDbtag::eDbtagType_RFAM } },
  { "RGD",                 { CDbtag::fGenBank, CDbtag::eDbtagType_RGD } },
  { "RNAcentral",          { CDbtag::fGenBank, CDbtag::eDbtagType_RNAcentral } },
  { "RZPD",                { CDbtag::fGenBank | CDbtag::fSrc, CDbtag::eDbtagType_RZPD } },
  { "RiceGenes",           { CDbtag::fGenBank, CDbtag::eDbtagType_RiceGenes } },
  { "SEED",                { CDbtag::fGenBank, CDbtag::eDbtagType_SEED } },
  { "SGD",                 { CDbtag::fGenBank, CDbtag::eDbtagType_SGD } },
  { "SGN",                 { CDbtag::fGenBank, CDbtag::eDbtagType_SGN } },
  { "SoyBase",             { CDbtag::fGenBank, CDbtag::eDbtagType_SoyBase } },
  { "SubtiList",           { CDbtag::fGenBank, CDbtag::eDbtagType_SubtiList } },
  { "TAIR",                { CDbtag::fGenBank, CDbtag::eDbtagType_TAIR } },
  { "TIGRFAM",             { CDbtag::fGenBank, CDbtag::eDbtagType_TIGRFAM } },
  { "TubercuList",         { CDbtag::fGenBank | CDbtag::fSrc, CDbtag::eDbtagType_TubercuList } },
  { "UNILIB",              { CDbtag::fGenBank | CDbtag::fSrc, CDbtag::eDbtagType_UNILIB } },
  { "UNITE",               { CDbtag::fGenBank | CDbtag::fSrc, CDbtag::eDbtagType_UNITE } },
  { "UniGene",             { CDbtag::fGenBank, CDbtag::eDbtagType_UniGene } },
  { "UniProtKB/Swiss-Prot",{ CDbtag::fGenBank, CDbtag::eDbtagType_UniProt_SwissProt } },
  { "UniProtKB/TrEMBL",    { CDbtag::fGenBank, CDbtag::eDbtagType_UniProt_TrEMBL } },
  { "UniSTS",              { CDbtag::fGenBank, CDbtag::eDbtagType_UniSTS } },
  { "VBASE2",              { CDbtag::fGenBank, CDbtag::eDbtagType_VBASE2 } },
  { "VGNC",                { CDbtag::fGenBank, CDbtag::eDbtagType_VGNC } },
  { "VISTA",               { CDbtag::fGenBank, CDbtag::eDbtagType_VISTA } },
  { "VectorBase",          { CDbtag::fGenBank, CDbtag::eDbtagType_VectorBase } },
  { "Vega",                { CDbtag::fGenBank, CDbtag::eDbtagType_Vega } },
  { "ViPR",                { CDbtag::fGenBank, CDbtag::eDbtagType_ViPR } },
  { "WorfDB",              { CDbtag::fGenBank, CDbtag::eDbtagType_WorfDB } },
  { "WormBase",            { CDbtag::fGenBank, CDbtag::eDbtagType_WormBase } },
  { "Xenbase",             { CDbtag::fGenBank, CDbtag::eDbtagType_Xenbase } },
  { "ZFIN",                { CDbtag::fGenBank, CDbtag::eDbtagType_ZFIN } },
  { "dbClone",             { CDbtag::fGenBank, CDbtag::eDbtagType_dbClone } },
  { "dbCloneLib",          { CDbtag::fGenBank, CDbtag::eDbtagType_dbCloneLib } },
  { "dbEST",               { CDbtag::fGenBank, CDbtag::eDbtagType_dbEST } },
  { "dbProbe",             { CDbtag::fGenBank, CDbtag::eDbtagType_dbProbe } },
  { "dbSNP",               { CDbtag::fGenBank, CDbtag::eDbtagType_dbSNP } },
  { "dbSTS",               { CDbtag::fGenBank, CDbtag::eDbtagType_dbSTS } },
  { "dbVar",               { CDbtag::fRefSeq, CDbtag::eDbtagType_dbVar } },
  { "dictyBase",           { CDbtag::fGenBank, CDbtag::eDbtagType_dictyBase } },
  { "miRBase",             { CDbtag::fGenBank, CDbtag::eDbtagType_miRBase } },
  { "niaEST",              { CDbtag::fGenBank, CDbtag::eDbtagType_niaEST } },
  { "taxon",               { CDbtag::fGenBank | CDbtag::fSrc, CDbtag::eDbtagType_taxon } },

  { "AllianceGenome",      { CDbtag::fRefSeq, CDbtag::eDbtagType_AllianceGenome } },
  { "BioProject",          { CDbtag::fRefSeq, CDbtag::eDbtagType_BioProject } },
  { "BioSample",           { CDbtag::fRefSeq, CDbtag::eDbtagType_BioSample } },
  { "CCDS",                { CDbtag::fRefSeq, CDbtag::eDbtagType_CCDS } },
  { "CGNC",                { CDbtag::fRefSeq, CDbtag::eDbtagType_CGNC } },
  { "CloneID",             { CDbtag::fRefSeq, CDbtag::eDbtagType_CloneID } },
  { "EPDnew",              { CDbtag::fRefSeq, CDbtag::eDbtagType_EPDnew } },
  { "HPM",                 { CDbtag::fRefSeq, CDbtag::eDbtagType_HPM } },
  { "HPRD",                { CDbtag::fRefSeq, CDbtag::eDbtagType_HPRD } },
  { "LRG",                 { CDbtag::fRefSeq, CDbtag::eDbtagType_LRG } },
  { "NASONIABASE",         { CDbtag::fRefSeq, CDbtag::eDbtagType_NASONIABASE } },
  { "PBR",                 { CDbtag::fRefSeq, CDbtag::eDbtagType_PBR } },
  { "REBASE",              { CDbtag::fRefSeq, CDbtag::eDbtagType_REBASE } },
  { "RefSeq",              { CDbtag::fRefSeq | CDbtag::fProbe, CDbtag::eDbtagType_RefSeq } },
  { "SK-FST",              { CDbtag::fRefSeq, CDbtag::eDbtagType_SK_FST } },
  { "SRPDB",               { CDbtag::fRefSeq, CDbtag::eDbtagType_SRPDB } },
  { "VBRC",                { CDbtag::fRefSeq, CDbtag::eDbtagType_VBRC } },

  { "Fungorum",            { CDbtag::fSrc, CDbtag::eDbtagType_Fungorum } },
  { "RBGE_garden",         { CDbtag::fSrc, CDbtag::eDbtagType_RBGE_garden } },
  { "RBGE_herbarium",      { CDbtag::fSrc, CDbtag::eDbtagType_RBGE_herbarium } },

  { "Assembly",            { CDbtag::fProbe, CDbtag::eDbtagType_Assembly } },
  { "BB",                  { CDbtag::fProbe, CDbtag::eDbtagType_BB } },
  { "CollecTF",            { CDbtag::fProbe, CDbtag::eDbtagType_CollecTF } },
  { "DDBJ",                { CDbtag::fProbe, CDbtag::eDbtagType_DDBJ } },
  { "EMBL",                { CDbtag::fProbe, CDbtag::eDbtagType_EMBL } },
  { "GEO",                 { CDbtag::fProbe, CDbtag::eDbtagType_GEO } },
  { "GenBank",             { CDbtag::fProbe | CDbtag::fSrc, CDbtag::eDbtagType_GenBank } },
  { "GrainGenes",          { CDbtag::fProbe, CDbtag::eDbtagType_GrainGenes } },
  { "PubChem",             { CDbtag::fProbe, CDbtag::eDbtagType_PubChem } },
  { "SRA",                 { CDbtag::fProbe, CDbtag::eDbtagType_SRA } },
  { "Trace",               { CDbtag::fProbe, CDbtag::eDbtagType_Trace } },

  { "AmoebaDB",            { CDbtag::fRefSeq, CDbtag::eDbtagType_AmoebaDB } },
  { "CryptoDB",            { CDbtag::fRefSeq, CDbtag::eDbtagType_CryptoDB } },
  { "FungiDB",             { CDbtag::fRefSeq, CDbtag::eDbtagType_FungiDB } },
  { "GiardiaDB",           { CDbtag::fRefSeq, CDbtag::eDbtagType_GiardiaDB } },
  { "MicrosporidiaDB",     { CDbtag::fRefSeq, CDbtag::eDbtagType_MicrosporidiaDB } },
  { "PiroplasmaDB",        { CDbtag::fRefSeq, CDbtag::eDbtagType_PiroplasmaDB } },
  { "PlasmoDB",            { CDbtag::fRefSeq, CDbtag::eDbtagType_PlasmoDB } },
  { "ToxoDB",              { CDbtag::fRefSeq, CDbtag::eDbtagType_ToxoDB } },
  { "TrichDB",             { CDbtag::fRefSeq, CDbtag::eDbtagType_TrichDB } },
  { "TriTrypDB",           { CDbtag::fRefSeq, CDbtag::eDbtagType_TriTrypDB } },
  { "VEuPathDB",           { CDbtag::fRefSeq, CDbtag::eDbtagType_VEuPathDB } },

  { "NCBIOrtholog",        { CDbtag::fGenBank, CDbtag::eDbtagType_NCBIOrtholog } },

// Note from RW-1843: INSDC documentation contains outdated information
// It requires ENSEMBL and PseudoCap, but actially Ensembl and PseudoCAP are correct
// https://www.insdc.org/submitting-standards/dbxref-qualifier-vocabulary/
// This software allows both
  { "Ensembl",             { CDbtag::fGenBank, CDbtag::eDbtagType_Ensembl, "ENSEMBL" } },
  { "EnsemblNew",          { CDbtag::fGenBank, CDbtag::eDbtagType_EnsemblNew, "EnsemblNew" } },
  { "PseudoCAP",           { CDbtag::fGenBank, CDbtag::eDbtagType_PseudoCAP, "PseudoCap" } },
