/*  $Id$
 * ==========================================================================
 *
 *                            PUBLIC DOMAIN NOTICE
 *               National Center for Biotechnology Information
 *
 *  This software/database is a "United States Government Work" under the
 *  terms of the United States Copyright Act.  It was written as part of
 *  the author's official duties as a United States Government employee and
 *  thus cannot be copyrighted.  This software/database is freely available
 *  to the public for use. The National Library of Medicine and the U.S.
 *  Government have not placed any restriction on its use or reproduction.
 *
 *  Although all reasonable efforts have been taken to ensure the accuracy
 *  and reliability of the software and data, the NLM and the U.S.
 *  Government do not and cannot warrant the performance or results that
 *  may be obtained by using this software or data. The NLM and the U.S.
 *  Government disclaim all warranties, express or implied, including
 *  warranties of performance, merchantability or fitness for any particular
 *  purpose.
 *
 *  Please cite the author in any work or product based on this material.
 *
 * ==========================================================================
 *
 * Author: Aleksey Vinokurov
 *
 * File Description:
 *    Unicode transformation library
 *    Plan E7
 *
 */

static TUnicodePlan s_Plan_E7h = {
    { 0, eString },  // U+E700
    { 0, eString },  // U+E701
    { 0, eString },  // U+E702
    { 0, eString },  // U+E703
    { 0, eString },  // U+E704
    { 0, eString },  // U+E705
    { 0, eString },  // U+E706
    { 0, eString },  // U+E707
    { 0, eString },  // U+E708
    { 0, eString },  // U+E709
    { 0, eString },  // U+E70A
    { 0, eString },  // U+E70B
    { 0, eString },  // U+E70C
    { 0, eString },  // U+E70D
    { 0, eString },  // U+E70E
    { 0, eString },  // U+E70F
    { 0, eString },  // U+E710
    { 0, eString },  // U+E711
    { 0, eString },  // U+E712
    { 0, eString },  // U+E713
    { 0, eString },  // U+E714
    { 0, eString },  // U+E715
    { 0, eString },  // U+E716
    { 0, eString },  // U+E717
    { 0, eString },  // U+E718
    { 0, eString },  // U+E719
    { 0, eString },  // U+E71A
    { 0, eString },  // U+E71B
    { 0, eString },  // U+E71C
    { 0, eString },  // U+E71D
    { 0, eString },  // U+E71E
    { 0, eString },  // U+E71F
    { 0, eString },  // U+E720
    { 0, eString },  // U+E721
    { 0, eString },  // U+E722
    { 0, eString },  // U+E723
    { 0, eString },  // U+E724
    { 0, eString },  // U+E725
    { 0, eString },  // U+E726
    { 0, eString },  // U+E727
    { 0, eString },  // U+E728
    { 0, eString },  // U+E729
    { 0, eString },  // U+E72A
    { 0, eString },  // U+E72B
    { 0, eString },  // U+E72C
    { 0, eString },  // U+E72D
    { 0, eString },  // U+E72E
    { 0, eString },  // U+E72F
    { 0, eString },  // U+E730
    { 0, eString },  // U+E731
    { 0, eString },  // U+E732
    { 0, eString },  // U+E733
    { 0, eString },  // U+E734
    { 0, eString },  // U+E735
    { 0, eString },  // U+E736
    { 0, eString },  // U+E737
    { 0, eString },  // U+E738
    { 0, eString },  // U+E739
    { 0, eString },  // U+E73A
    { 0, eString },  // U+E73B
    { 0, eString },  // U+E73C
    { 0, eString },  // U+E73D
    { 0, eString },  // U+E73E
    { 0, eString },  // U+E73F
    { 0, eString },  // U+E740
    { 0, eString },  // U+E741
    { 0, eString },  // U+E742
    { 0, eString },  // U+E743
    { 0, eString },  // U+E744
    { 0, eString },  // U+E745
    { 0, eString },  // U+E746
    { 0, eString },  // U+E747
    { 0, eString },  // U+E748
    { 0, eString },  // U+E749
    { 0, eString },  // U+E74A
    { 0, eString },  // U+E74B
    { 0, eString },  // U+E74C
    { 0, eString },  // U+E74D
    { 0, eString },  // U+E74E
    { 0, eString },  // U+E74F
    { 0, eString },  // U+E750
    { 0, eString },  // U+E751
    { 0, eString },  // U+E752
    { 0, eString },  // U+E753
    { 0, eString },  // U+E754
    { 0, eString },  // U+E755
    { 0, eString },  // U+E756
    { 0, eString },  // U+E757
    { 0, eString },  // U+E758
    { 0, eString },  // U+E759
    { 0, eString },  // U+E75A
    { 0, eString },  // U+E75B
    { 0, eString },  // U+E75C
    { 0, eString },  // U+E75D
    { 0, eString },  // U+E75E
    { 0, eString },  // U+E75F
    { 0, eString },  // U+E760
    { 0, eString },  // U+E761
    { 0, eString },  // U+E762
    { 0, eString },  // U+E763
    { 0, eString },  // U+E764
    { 0, eString },  // U+E765
    { 0, eString },  // U+E766
    { 0, eString },  // U+E767
    { 0, eString },  // U+E768
    { 0, eString },  // U+E769
    { 0, eString },  // U+E76A
    { 0, eString },  // U+E76B
    { 0, eString },  // U+E76C
    { 0, eString },  // U+E76D
    { 0, eString },  // U+E76E
    { 0, eString },  // U+E76F
    { 0, eString },  // U+E770
    { 0, eString },  // U+E771
    { 0, eString },  // U+E772
    { 0, eString },  // U+E773
    { 0, eString },  // U+E774
    { 0, eString },  // U+E775
    { 0, eString },  // U+E776
    { 0, eString },  // U+E777
    { 0, eString },  // U+E778
    { 0, eString },  // U+E779
    { 0, eString },  // U+E77A
    { 0, eString },  // U+E77B
    { 0, eString },  // U+E77C
    { 0, eString },  // U+E77D
    { 0, eString },  // U+E77E
    { 0, eString },  // U+E77F
    { 0, eString },  // U+E780
    { 0, eString },  // U+E781
    { 0, eString },  // U+E782
    { 0, eString },  // U+E783
    { 0, eString },  // U+E784
    { 0, eString },  // U+E785
    { 0, eString },  // U+E786
    { 0, eString },  // U+E787
    { 0, eString },  // U+E788
    { 0, eString },  // U+E789
    { 0, eString },  // U+E78A
    { 0, eString },  // U+E78B
    { 0, eString },  // U+E78C
    { 0, eString },  // U+E78D
    { 0, eString },  // U+E78E
    { 0, eString },  // U+E78F
    { 0, eString },  // U+E790
    { 0, eString },  // U+E791
    { 0, eString },  // U+E792
    { 0, eString },  // U+E793
    { 0, eString },  // U+E794
    { 0, eString },  // U+E795
    { 0, eString },  // U+E796
    { 0, eString },  // U+E797
    { 0, eString },  // U+E798
    { 0, eString },  // U+E799
    { 0, eString },  // U+E79A
    { 0, eString },  // U+E79B
    { 0, eString },  // U+E79C
    { 0, eString },  // U+E79D
    { 0, eString },  // U+E79E
    { 0, eString },  // U+E79F
    { 0, eString },  // U+E7A0
    { 0, eString },  // U+E7A1
    { 0, eString },  // U+E7A2
    { 0, eString },  // U+E7A3
    { 0, eString },  // U+E7A4
    { 0, eString },  // U+E7A5
    { 0, eString },  // U+E7A6
    { 0, eString },  // U+E7A7
    { 0, eString },  // U+E7A8
    { 0, eString },  // U+E7A9
    { 0, eString },  // U+E7AA
    { 0, eString },  // U+E7AB
    { 0, eString },  // U+E7AC
    { 0, eString },  // U+E7AD
    { 0, eString },  // U+E7AE
    { 0, eString },  // U+E7AF
    { 0, eString },  // U+E7B0
    { 0, eString },  // U+E7B1
    { 0, eString },  // U+E7B2
    { 0, eString },  // U+E7B3
    { 0, eString },  // U+E7B4
    { 0, eString },  // U+E7B5
    { 0, eString },  // U+E7B6
    { 0, eString },  // U+E7B7
    { 0, eString },  // U+E7B8
    { 0, eString },  // U+E7B9
    { 0, eString },  // U+E7BA
    { 0, eString },  // U+E7BB
    { 0, eString },  // U+E7BC
    { 0, eString },  // U+E7BD
    { 0, eString },  // U+E7BE
    { 0, eString },  // U+E7BF
    { 0, eString },  // U+E7C0
    { 0, eString },  // U+E7C1
    { 0, eString },  // U+E7C2
    { 0, eString },  // U+E7C3
    { 0, eString },  // U+E7C4
    { 0, eString },  // U+E7C5
    { 0, eString },  // U+E7C6
    { 0, eString },  // U+E7C7
    { 0, eString },  // U+E7C8
    { 0, eString },  // U+E7C9
    { 0, eString },  // U+E7CA
    { 0, eString },  // U+E7CB
    { 0, eString },  // U+E7CC
    { 0, eString },  // U+E7CD
    { 0, eString },  // U+E7CE
    { 0, eString },  // U+E7CF
    { 0, eString },  // U+E7D0
    { 0, eString },  // U+E7D1
    { 0, eString },  // U+E7D2
    { 0, eString },  // U+E7D3
    { 0, eString },  // U+E7D4
    { 0, eString },  // U+E7D5
    { 0, eString },  // U+E7D6
    { 0, eString },  // U+E7D7
    { 0, eString },  // U+E7D8
    { 0, eString },  // U+E7D9
    { 0, eString },  // U+E7DA
    { 0, eString },  // U+E7DB
    { 0, eString },  // U+E7DC
    { 0, eString },  // U+E7DD
    { 0, eString },  // U+E7DE
    { 0, eString },  // U+E7DF
    { 0, eString },  // U+E7E0
    { 0, eString },  // U+E7E1
    { 0, eString },  // U+E7E2
    { 0, eString },  // U+E7E3
    { 0, eString },  // U+E7E4
    { 0, eString },  // U+E7E5
    { 0, eString },  // U+E7E6
    { 0, eString },  // U+E7E7
    { 0, eString },  // U+E7E8
    { 0, eString },  // U+E7E9
    { 0, eString },  // U+E7EA
    { 0, eString },  // U+E7EB
    { 0, eString },  // U+E7EC
    { 0, eString },  // U+E7ED
    { 0, eString },  // U+E7EE
    { 0, eString },  // U+E7EF
    { 0, eString },  // U+E7F0
    { 0, eString },  // U+E7F1
    { 0, eString },  // U+E7F2
    { 0, eString },  // U+E7F3
    { 0, eString },  // U+E7F4
    { 0, eString },  // U+E7F5
    { 0, eString },  // U+E7F6
    { 0, eString },  // U+E7F7
    { 0, eString },  // U+E7F8
    { 0, eString },  // U+E7F9
    { 0, eString },  // U+E7FA
    { 0, eString },  // U+E7FB
    { 0, eString },  // U+E7FC
    { 0, eString },  // U+E7FD
    { 0, eString },  // U+E7FE
    { 0, eString },  // U+E7FF
};

/*
 * ==========================================================================
 * $Log$
 * Revision 1.1  2004/05/06 18:21:26  gouriano
 * Imported from pubmed/xmldb
 *
 * ==========================================================================
 */
