/*  $Id$
 * ==========================================================================
 *
 *                            PUBLIC DOMAIN NOTICE
 *               National Center for Biotechnology Information
 *
 *  This software/database is a "United States Government Work" under the
 *  terms of the United States Copyright Act.  It was written as part of
 *  the author's official duties as a United States Government employee and
 *  thus cannot be copyrighted.  This software/database is freely available
 *  to the public for use. The National Library of Medicine and the U.S.
 *  Government have not placed any restriction on its use or reproduction.
 *
 *  Although all reasonable efforts have been taken to ensure the accuracy
 *  and reliability of the software and data, the NLM and the U.S.
 *  Government do not and cannot warrant the performance or results that
 *  may be obtained by using this software or data. The NLM and the U.S.
 *  Government disclaim all warranties, express or implied, including
 *  warranties of performance, merchantability or fitness for any particular
 *  purpose.
 *
 *  Please cite the author in any work or product based on this material.
 *
 * ==========================================================================
 *
 * Author: Aleksey Vinokurov
 *
 * File Description:
 *    Unicode transformation library
 *    Plan E4
 *
 */

static TUnicodePlan s_Plan_E4h = {
    { "right, curved, down arrow ", eString },  //                  U+E400
    { 0, eString },  //                                          U+E401
    { "left broken arrow", eString },  //                           U+E402
    { 0, eString },  //                                          U+E403
    { 0, eString },  //                                          U+E404
    { "right broken arrow", eString },  //                          U+E405
    { 0, eString },  //                                          U+E406
    { 0, eString },  //                                          U+E407
    { 0, eString },  //                                          U+E408
    { "large circle in circle", eString },  //                      U+E409
    { "vertical bar in circle", eString },  //                      U+E40A
    { 0, eString },  //                                          U+E40B
    { "reverse most positive, line below", eString },  //           U+E40C
    { 0, eString },  //                                          U+E40D
    { 0, eString },  //                                          U+E40E
    { 0, eString },  //                                          U+E40F
    { 0, eString },  //                                          U+E410
    { 0, eString },  //                                          U+E411
    { 0, eString },  //                                          U+E412
    { 0, eString },  //                                          U+E413
    { 0, eString },  //                                          U+E414
    { "not, vert, similar", eString },  //                          U+E415
    { "solidus, bar through", eString },  //                        U+E416
    { 0, eString },  //                                          U+E417
    { "right angle-measured", eString },  //                        U+E418
    { "bottom above top square bracket", eString },  //             U+E419
    { "reversed circle, slash", eString },  //                      U+E41A
    { "circle, two horizontal stroked to the right", eString },  // U+E41B
    { "circle, small circle to the right", eString },  //           U+E41C
    { 0, eString },  //                                          U+E41D
    { 0, eString },  //                                          U+E41E
    { 0, eString },  //                                          U+E41F
    { 0, eString },  //                                          U+E420
    { 0, eString },  //                                          U+E421
    { 0, eString },  //                                          U+E422
    { 0, eString },  //                                          U+E423
    { 0, eString },  //                                          U+E424
    { 0, eString },  //                                          U+E425
    { 0, eString },  //                                          U+E426
    { 0, eString },  //                                          U+E427
    { 0, eString },  //                                          U+E428
    { " thick similar", eString },  // old dictionary               U+E429
    { 0, eString },  //                                          U+E42A
    { 0, eString },  //                                          U+E42B
    { 0, eString },  //                                          U+E42C
    { 0, eString },  //                                          U+E42D
    { 0, eString },  //                                          U+E42E
    { 0, eString },  //                                          U+E42F
    { 0, eString },  //                                          U+E430
    { 0, eString },  //                                          U+E431
    { 0, eString },  //                                          U+E432
    { 0, eString },  //                                          U+E433
    { 0, eString },  //                                          U+E434
    { 0, eString },  //                                          U+E435
    { 0, eString },  //                                          U+E436
    { 0, eString },  //                                          U+E437
    { 0, eString },  //                                          U+E438
    { 0, eString },  //                                          U+E439
    { 0, eString },  //                                          U+E43A
    { 0, eString },  //                                          U+E43B
    { 0, eString },  //                                          U+E43C
    { 0, eString },  //                                          U+E43D
    { 0, eString },  //                                          U+E43E
    { 0, eString },  //                                          U+E43F
    { 0, eString },  //                                          U+E440
    { 0, eString },  //                                          U+E441
    { 0, eString },  //                                          U+E442
    { 0, eString },  //                                          U+E443
    { 0, eString },  //                                          U+E444
    { 0, eString },  //                                          U+E445
    { 0, eString },  //                                          U+E446
    { 0, eString },  //                                          U+E447
    { 0, eString },  //                                          U+E448
    { 0, eString },  //                                          U+E449
    { 0, eString },  //                                          U+E44A
    { 0, eString },  //                                          U+E44B
    { 0, eString },  //                                          U+E44C
    { 0, eString },  //                                          U+E44D
    { 0, eString },  //                                          U+E44E
    { 0, eString },  //                                          U+E44F
    { 0, eString },  //                                          U+E450
    { 0, eString },  //                                          U+E451
    { 0, eString },  //                                          U+E452
    { 0, eString },  //                                          U+E453
    { 0, eString },  //                                          U+E454
    { 0, eString },  //                                          U+E455
    { 0, eString },  //                                          U+E456
    { 0, eString },  //                                          U+E457
    { 0, eString },  //                                          U+E458
    { 0, eString },  //                                          U+E459
    { 0, eString },  //                                          U+E45A
    { 0, eString },  //                                          U+E45B
    { 0, eString },  //                                          U+E45C
    { 0, eString },  //                                          U+E45D
    { 0, eString },  //                                          U+E45E
    { 0, eString },  //                                          U+E45F
    { 0, eString },  //                                          U+E460
    { 0, eString },  //                                          U+E461
    { 0, eString },  //                                          U+E462
    { 0, eString },  //                                          U+E463
    { 0, eString },  //                                          U+E464
    { 0, eString },  //                                          U+E465
    { 0, eString },  //                                          U+E466
    { 0, eString },  //                                          U+E467
    { 0, eString },  //                                          U+E468
    { 0, eString },  //                                          U+E469
    { 0, eString },  //                                          U+E46A
    { 0, eString },  //                                          U+E46B
    { 0, eString },  //                                          U+E46C
    { 0, eString },  //                                          U+E46D
    { 0, eString },  //                                          U+E46E
    { 0, eString },  //                                          U+E46F
    { 0, eString },  //                                          U+E470
    { 0, eString },  //                                          U+E471
    { 0, eString },  //                                          U+E472
    { 0, eString },  //                                          U+E473
    { 0, eString },  //                                          U+E474
    { 0, eString },  //                                          U+E475
    { 0, eString },  //                                          U+E476
    { 0, eString },  //                                          U+E477
    { 0, eString },  //                                          U+E478
    { 0, eString },  //                                          U+E479
    { 0, eString },  //                                          U+E47A
    { 0, eString },  //                                          U+E47B
    { 0, eString },  //                                          U+E47C
    { 0, eString },  //                                          U+E47D
    { 0, eString },  //                                          U+E47E
    { 0, eString },  //                                          U+E47F
    { 0, eString },  //                                          U+E480
    { 0, eString },  //                                          U+E481
    { 0, eString },  //                                          U+E482
    { 0, eString },  //                                          U+E483
    { 0, eString },  //                                          U+E484
    { 0, eString },  //                                          U+E485
    { 0, eString },  //                                          U+E486
    { 0, eString },  //                                          U+E487
    { 0, eString },  //                                          U+E488
    { 0, eString },  //                                          U+E489
    { 0, eString },  //                                          U+E48A
    { 0, eString },  //                                          U+E48B
    { 0, eString },  //                                          U+E48C
    { 0, eString },  //                                          U+E48D
    { 0, eString },  //                                          U+E48E
    { 0, eString },  //                                          U+E48F
    { 0, eString },  //                                          U+E490
    { 0, eString },  //                                          U+E491
    { 0, eString },  //                                          U+E492
    { 0, eString },  //                                          U+E493
    { 0, eString },  //                                          U+E494
    { 0, eString },  //                                          U+E495
    { 0, eString },  //                                          U+E496
    { 0, eString },  //                                          U+E497
    { 0, eString },  //                                          U+E498
    { 0, eString },  //                                          U+E499
    { 0, eString },  //                                          U+E49A
    { 0, eString },  //                                          U+E49B
    { 0, eString },  //                                          U+E49C
    { 0, eString },  //                                          U+E49D
    { 0, eString },  //                                          U+E49E
    { 0, eString },  //                                          U+E49F
    { 0, eString },  //                                          U+E4A0
    { 0, eString },  //                                          U+E4A1
    { 0, eString },  //                                          U+E4A2
    { 0, eString },  //                                          U+E4A3
    { 0, eString },  //                                          U+E4A4
    { 0, eString },  //                                          U+E4A5
    { 0, eString },  //                                          U+E4A6
    { 0, eString },  //                                          U+E4A7
    { 0, eString },  //                                          U+E4A8
    { 0, eString },  //                                          U+E4A9
    { 0, eString },  //                                          U+E4AA
    { 0, eString },  //                                          U+E4AB
    { 0, eString },  //                                          U+E4AC
    { 0, eString },  //                                          U+E4AD
    { 0, eString },  //                                          U+E4AE
    { 0, eString },  //                                          U+E4AF
    { 0, eString },  //                                          U+E4B0
    { 0, eString },  //                                          U+E4B1
    { 0, eString },  //                                          U+E4B2
    { 0, eString },  //                                          U+E4B3
    { 0, eString },  //                                          U+E4B4
    { 0, eString },  //                                          U+E4B5
    { 0, eString },  //                                          U+E4B6
    { 0, eString },  //                                          U+E4B7
    { 0, eString },  //                                          U+E4B8
    { 0, eString },  //                                          U+E4B9
    { 0, eString },  //                                          U+E4BA
    { 0, eString },  //                                          U+E4BB
    { 0, eString },  //                                          U+E4BC
    { 0, eString },  //                                          U+E4BD
    { 0, eString },  //                                          U+E4BE
    { 0, eString },  //                                          U+E4BF
    { 0, eString },  //                                          U+E4C0
    { 0, eString },  //                                          U+E4C1
    { 0, eString },  //                                          U+E4C2
    { 0, eString },  //                                          U+E4C3
    { 0, eString },  //                                          U+E4C4
    { 0, eString },  //                                          U+E4C5
    { 0, eString },  //                                          U+E4C6
    { 0, eString },  //                                          U+E4C7
    { 0, eString },  //                                          U+E4C8
    { 0, eString },  //                                          U+E4C9
    { 0, eString },  //                                          U+E4CA
    { 0, eString },  //                                          U+E4CB
    { 0, eString },  //                                          U+E4CC
    { 0, eString },  //                                          U+E4CD
    { 0, eString },  //                                          U+E4CE
    { 0, eString },  //                                          U+E4CF
    { 0, eString },  //                                          U+E4D0
    { 0, eString },  //                                          U+E4D1
    { 0, eString },  //                                          U+E4D2
    { 0, eString },  //                                          U+E4D3
    { 0, eString },  //                                          U+E4D4
    { 0, eString },  //                                          U+E4D5
    { 0, eString },  //                                          U+E4D6
    { 0, eString },  //                                          U+E4D7
    { 0, eString },  //                                          U+E4D8
    { 0, eString },  //                                          U+E4D9
    { 0, eString },  //                                          U+E4DA
    { 0, eString },  //                                          U+E4DB
    { 0, eString },  //                                          U+E4DC
    { 0, eString },  //                                          U+E4DD
    { 0, eString },  //                                          U+E4DE
    { 0, eString },  //                                          U+E4DF
    { 0, eString },  //                                          U+E4E0
    { 0, eString },  //                                          U+E4E1
    { 0, eString },  //                                          U+E4E2
    { 0, eString },  //                                          U+E4E3
    { 0, eString },  //                                          U+E4E4
    { 0, eString },  //                                          U+E4E5
    { 0, eString },  //                                          U+E4E6
    { 0, eString },  //                                          U+E4E7
    { 0, eString },  //                                          U+E4E8
    { 0, eString },  //                                          U+E4E9
    { 0, eString },  //                                          U+E4EA
    { 0, eString },  //                                          U+E4EB
    { 0, eString },  //                                          U+E4EC
    { 0, eString },  //                                          U+E4ED
    { 0, eString },  //                                          U+E4EE
    { 0, eString },  //                                          U+E4EF
    { 0, eString },  //                                          U+E4F0
    { 0, eString },  //                                          U+E4F1
    { 0, eString },  //                                          U+E4F2
    { 0, eString },  //                                          U+E4F3
    { 0, eString },  //                                          U+E4F4
    { 0, eString },  //                                          U+E4F5
    { 0, eString },  //                                          U+E4F6
    { 0, eString },  //                                          U+E4F7
    { 0, eString },  //                                          U+E4F8
    { 0, eString },  //                                          U+E4F9
    { 0, eString },  //                                          U+E4FA
    { 0, eString },  //                                          U+E4FB
    { 0, eString },  //                                          U+E4FC
    { 0, eString },  //                                          U+E4FD
    { 0, eString },  //                                          U+E4FE
    { 0, eString },  //                                          U+E4FF
};

/*
 * ==========================================================================
 * $Log$
 * Revision 1.1  2004/05/06 18:21:25  gouriano
 * Imported from pubmed/xmldb
 *
 * ==========================================================================
 */
