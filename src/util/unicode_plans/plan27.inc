/*  $Id$
 * ==========================================================================
 *
 *                            PUBLIC DOMAIN NOTICE
 *               National Center for Biotechnology Information
 *
 *  This software/database is a "United States Government Work" under the
 *  terms of the United States Copyright Act.  It was written as part of
 *  the author's official duties as a United States Government employee and
 *  thus cannot be copyrighted.  This software/database is freely available
 *  to the public for use. The National Library of Medicine and the U.S.
 *  Government have not placed any restriction on its use or reproduction.
 *
 *  Although all reasonable efforts have been taken to ensure the accuracy
 *  and reliability of the software and data, the NLM and the U.S.
 *  Government do not and cannot warrant the performance or results that
 *  may be obtained by using this software or data. The NLM and the U.S.
 *  Government disclaim all warranties, express or implied, including
 *  warranties of performance, merchantability or fitness for any particular
 *  purpose.
 *
 *  Please cite the author in any work or product based on this material.
 *
 * ==========================================================================
 *
 * Author: Aleksey Vinokurov
 *
 * File Description:
 *    Unicode transformation library
 *    Plan 27
 *
 */

static TUnicodePlan s_Plan_27h = {
    { 0, eString },  //                            U+2700
    { 0, eString },  //                            U+2701
    { 0, eString },  //                            U+2702
    { 0, eString },  //                            U+2703
    { 0, eString },  //                            U+2704
    { 0, eString },  //                            U+2705
    { 0, eString },  //                            U+2706
    { 0, eString },  //                            U+2707
    { 0, eString },  //                            U+2708
    { 0, eString },  //                            U+2709
    { 0, eString },  //                            U+270A
    { 0, eString },  //                            U+270B
    { 0, eString },  //                            U+270C
    { 0, eString },  //                            U+270D
    { 0, eString },  //                            U+270E
    { 0, eString },  //                            U+270F
    { 0, eString },  //                            U+2710
    { 0, eString },  //                            U+2711
    { 0, eString },  //                            U+2712
    { "check mark", eString },  // old dictionary     U+2713
    { 0, eString },  //                            U+2714
    { 0, eString },  //                            U+2715
    { 0, eString },  //                            U+2716
    { "ballot cross", eString },  // old dictionary   U+2717
    { 0, eString },  //                            U+2718
    { 0, eString },  //                            U+2719
    { 0, eString },  //                            U+271A
    { 0, eString },  //                            U+271B
    { 0, eString },  //                            U+271C
    { 0, eString },  //                            U+271D
    { 0, eString },  //                            U+271E
    { 0, eString },  //                            U+271F
    { "maltese cross", eString },  // old dictionary  U+2720
    { 0, eString },  //                            U+2721
    { 0, eString },  //                            U+2722
    { 0, eString },  //                            U+2723
    { 0, eString },  //                            U+2724
    { 0, eString },  //                            U+2725
    { 0, eString },  //                            U+2726
    { 0, eString },  //                            U+2727
    { 0, eString },  //                            U+2728
    { 0, eString },  //                            U+2729
    { 0, eString },  //                            U+272A
    { 0, eString },  //                            U+272B
    { 0, eString },  //                            U+272C
    { 0, eString },  //                            U+272D
    { 0, eString },  //                            U+272E
    { 0, eString },  //                            U+272F
    { 0, eString },  //                            U+2730
    { 0, eString },  //                            U+2731
    { 0, eString },  //                            U+2732
    { 0, eString },  //                            U+2733
    { 0, eString },  //                            U+2734
    { 0, eString },  //                            U+2735
    { "sextile", eString },  // old dictionary        U+2736
    { 0, eString },  //                            U+2737
    { 0, eString },  //                            U+2738
    { 0, eString },  //                            U+2739
    { 0, eString },  //                            U+273A
    { 0, eString },  //                            U+273B
    { 0, eString },  //                            U+273C
    { 0, eString },  //                            U+273D
    { 0, eString },  //                            U+273E
    { 0, eString },  //                            U+273F
    { 0, eString },  //                            U+2740
    { 0, eString },  //                            U+2741
    { 0, eString },  //                            U+2742
    { 0, eString },  //                            U+2743
    { 0, eString },  //                            U+2744
    { 0, eString },  //                            U+2745
    { 0, eString },  //                            U+2746
    { 0, eString },  //                            U+2747
    { 0, eString },  //                            U+2748
    { 0, eString },  //                            U+2749
    { 0, eString },  //                            U+274A
    { 0, eString },  //                            U+274B
    { 0, eString },  //                            U+274C
    { 0, eString },  //                            U+274D
    { 0, eString },  //                            U+274E
    { 0, eString },  //                            U+274F
    { 0, eString },  //                            U+2750
    { 0, eString },  //                            U+2751
    { 0, eString },  //                            U+2752
    { 0, eString },  //                            U+2753
    { 0, eString },  //                            U+2754
    { 0, eString },  //                            U+2755
    { 0, eString },  //                            U+2756
    { 0, eString },  //                            U+2757
    { 0, eString },  //                            U+2758
    { 0, eString },  //                            U+2759
    { 0, eString },  //                            U+275A
    { 0, eString },  //                            U+275B
    { 0, eString },  //                            U+275C
    { 0, eString },  //                            U+275D
    { 0, eString },  //                            U+275E
    { 0, eString },  //                            U+275F
    { 0, eString },  //                            U+2760
    { 0, eString },  //                            U+2761
    { 0, eString },  //                            U+2762
    { 0, eString },  //                            U+2763
    { 0, eString },  //                            U+2764
    { 0, eString },  //                            U+2765
    { 0, eString },  //                            U+2766
    { 0, eString },  //                            U+2767
    { 0, eString },  //                            U+2768
    { 0, eString },  //                            U+2769
    { 0, eString },  //                            U+276A
    { 0, eString },  //                            U+276B
    { 0, eString },  //                            U+276C
    { 0, eString },  //                            U+276D
    { 0, eString },  //                            U+276E
    { 0, eString },  //                            U+276F
    { 0, eString },  //                            U+2770
    { 0, eString },  //                            U+2771
    { 0, eString },  //                            U+2772
    { 0, eString },  //                            U+2773
    { 0, eString },  //                            U+2774
    { 0, eString },  //                            U+2775
    { 0, eString },  //                            U+2776
    { 0, eString },  //                            U+2777
    { 0, eString },  //                            U+2778
    { 0, eString },  //                            U+2779
    { 0, eString },  //                            U+277A
    { 0, eString },  //                            U+277B
    { 0, eString },  //                            U+277C
    { 0, eString },  //                            U+277D
    { 0, eString },  //                            U+277E
    { 0, eString },  //                            U+277F
    { 0, eString },  //                            U+2780
    { 0, eString },  //                            U+2781
    { 0, eString },  //                            U+2782
    { 0, eString },  //                            U+2783
    { 0, eString },  //                            U+2784
    { 0, eString },  //                            U+2785
    { 0, eString },  //                            U+2786
    { 0, eString },  //                            U+2787
    { 0, eString },  //                            U+2788
    { 0, eString },  //                            U+2789
    { 0, eString },  //                            U+278A
    { 0, eString },  //                            U+278B
    { 0, eString },  //                            U+278C
    { 0, eString },  //                            U+278D
    { 0, eString },  //                            U+278E
    { 0, eString },  //                            U+278F
    { 0, eString },  //                            U+2790
    { 0, eString },  //                            U+2791
    { 0, eString },  //                            U+2792
    { 0, eString },  //                            U+2793
    { 0, eString },  //                            U+2794
    { 0, eString },  //                            U+2795
    { 0, eString },  //                            U+2796
    { 0, eString },  //                            U+2797
    { 0, eString },  //                            U+2798
    { 0, eString },  //                            U+2799
    { 0, eString },  //                            U+279A
    { 0, eString },  //                            U+279B
    { 0, eString },  //                            U+279C
    { 0, eString },  //                            U+279D
    { 0, eString },  //                            U+279E
    { 0, eString },  //                            U+279F
    { 0, eString },  //                            U+27A0
    { 0, eString },  //                            U+27A1
    { 0, eString },  //                            U+27A2
    { 0, eString },  //                            U+27A3
    { 0, eString },  //                            U+27A4
    { 0, eString },  //                            U+27A5
    { 0, eString },  //                            U+27A6
    { 0, eString },  //                            U+27A7
    { 0, eString },  //                            U+27A8
    { 0, eString },  //                            U+27A9
    { 0, eString },  //                            U+27AA
    { 0, eString },  //                            U+27AB
    { 0, eString },  //                            U+27AC
    { 0, eString },  //                            U+27AD
    { 0, eString },  //                            U+27AE
    { 0, eString },  //                            U+27AF
    { 0, eString },  //                            U+27B0
    { 0, eString },  //                            U+27B1
    { 0, eString },  //                            U+27B2
    { 0, eString },  //                            U+27B3
    { 0, eString },  //                            U+27B4
    { 0, eString },  //                            U+27B5
    { 0, eString },  //                            U+27B6
    { 0, eString },  //                            U+27B7
    { 0, eString },  //                            U+27B8
    { 0, eString },  //                            U+27B9
    { 0, eString },  //                            U+27BA
    { 0, eString },  //                            U+27BB
    { 0, eString },  //                            U+27BC
    { 0, eString },  //                            U+27BD
    { 0, eString },  //                            U+27BE
    { 0, eString },  //                            U+27BF
    { 0, eString },  //                            U+27C0
    { 0, eString },  //                            U+27C1
    { 0, eString },  //                            U+27C2
    { 0, eString },  //                            U+27C3
    { 0, eString },  //                            U+27C4
    { 0, eString },  //                            U+27C5
    { 0, eString },  //                            U+27C6
    { 0, eString },  //                            U+27C7
    { 0, eString },  //                            U+27C8
    { 0, eString },  //                            U+27C9
    { 0, eString },  //                            U+27CA
    { 0, eString },  //                            U+27CB
    { 0, eString },  //                            U+27CC
    { 0, eString },  //                            U+27CD
    { 0, eString },  //                            U+27CE
    { 0, eString },  //                            U+27CF
    { 0, eString },  //                            U+27D0
    { 0, eString },  //                            U+27D1
    { 0, eString },  //                            U+27D2
    { 0, eString },  //                            U+27D3
    { 0, eString },  //                            U+27D4
    { 0, eString },  //                            U+27D5
    { 0, eString },  //                            U+27D6
    { 0, eString },  //                            U+27D7
    { 0, eString },  //                            U+27D8
    { 0, eString },  //                            U+27D9
    { 0, eString },  //                            U+27DA
    { 0, eString },  //                            U+27DB
    { 0, eString },  //                            U+27DC
    { 0, eString },  //                            U+27DD
    { 0, eString },  //                            U+27DE
    { 0, eString },  //                            U+27DF
    { 0, eString },  //                            U+27E0
    { 0, eString },  //                            U+27E1
    { 0, eString },  //                            U+27E2
    { 0, eString },  //                            U+27E3
    { 0, eString },  //                            U+27E4
    { 0, eString },  //                            U+27E5
    { 0, eString },  //                            U+27E6
    { 0, eString },  //                            U+27E7
    { 0, eString },  //                            U+27E8
    { 0, eString },  //                            U+27E9
    { 0, eString },  //                            U+27EA
    { 0, eString },  //                            U+27EB
    { 0, eString },  //                            U+27EC
    { 0, eString },  //                            U+27ED
    { 0, eString },  //                            U+27EE
    { 0, eString },  //                            U+27EF
    { 0, eString },  //                            U+27F0
    { 0, eString },  //                            U+27F1
    { 0, eString },  //                            U+27F2
    { 0, eString },  //                            U+27F3
    { 0, eString },  //                            U+27F4
    { 0, eString },  //                            U+27F5
    { 0, eString },  //                            U+27F6
    { 0, eString },  //                            U+27F7
    { 0, eString },  //                            U+27F8
    { 0, eString },  //                            U+27F9
    { 0, eString },  //                            U+27FA
    { 0, eString },  //                            U+27FB
    { 0, eString },  //                            U+27FC
    { 0, eString },  //                            U+27FD
    { 0, eString },  //                            U+27FE
    { 0, eString },  //                            U+27FF
};

/*
 * ==========================================================================
 * $Log$
 * Revision 1.1  2004/05/06 18:21:25  gouriano
 * Imported from pubmed/xmldb
 *
 * ==========================================================================
 */
