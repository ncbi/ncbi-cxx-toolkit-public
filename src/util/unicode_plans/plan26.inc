/*  $Id$
 * ==========================================================================
 *
 *                            PUBLIC DOMAIN NOTICE
 *               National Center for Biotechnology Information
 *
 *  This software/database is a "United States Government Work" under the
 *  terms of the United States Copyright Act.  It was written as part of
 *  the author's official duties as a United States Government employee and
 *  thus cannot be copyrighted.  This software/database is freely available
 *  to the public for use. The National Library of Medicine and the U.S.
 *  Government have not placed any restriction on its use or reproduction.
 *
 *  Although all reasonable efforts have been taken to ensure the accuracy
 *  and reliability of the software and data, the NLM and the U.S.
 *  Government do not and cannot warrant the performance or results that
 *  may be obtained by using this software or data. The NLM and the U.S.
 *  Government disclaim all warranties, express or implied, including
 *  warranties of performance, merchantability or fitness for any particular
 *  purpose.
 *
 *  Please cite the author in any work or product based on this material.
 *
 * ==========================================================================
 *
 * Author: Aleksey Vinokurov
 *
 * File Description:
 *    Unicode transformation library
 *    Plan 26
 *
 */

static TUnicodePlan s_Plan_26h = {
    { 0, eString },  //                               U+2600
    { 0, eString },  //                               U+2601
    { 0, eString },  //                               U+2602
    { 0, eString },  //                               U+2603
    { 0, eString },  //                               U+2604
    { " bigstar", eString },  // old dictionary          U+2605
    { 0, eString },  //                               U+2606
    { 0, eString },  //                               U+2607
    { 0, eString },  //                               U+2608
    { 0, eString },  //                               U+2609
    { 0, eString },  //                               U+260A
    { 0, eString },  //                               U+260B
    { 0, eString },  //                               U+260C
    { 0, eString },  //                               U+260D
    { "telephone symbol", eString },  // old dictionary  U+260E
    { 0, eString },  //                               U+260F
    { 0, eString },  //                               U+2610
    { 0, eString },  //                               U+2611
    { 0, eString },  //                               U+2612
    { 0, eString },  //                               U+2613
    { 0, eString },  //                               U+2614
    { 0, eString },  //                               U+2615
    { 0, eString },  //                               U+2616
    { 0, eString },  //                               U+2617
    { 0, eString },  //                               U+2618
    { 0, eString },  //                               U+2619
    { 0, eString },  //                               U+261A
    { 0, eString },  //                               U+261B
    { 0, eString },  //                               U+261C
    { 0, eString },  //                               U+261D
    { 0, eString },  //                               U+261E
    { 0, eString },  //                               U+261F
    { 0, eString },  //                               U+2620
    { 0, eString },  //                               U+2621
    { 0, eString },  //                               U+2622
    { 0, eString },  //                               U+2623
    { 0, eString },  //                               U+2624
    { 0, eString },  //                               U+2625
    { 0, eString },  //                               U+2626
    { 0, eString },  //                               U+2627
    { 0, eString },  //                               U+2628
    { 0, eString },  //                               U+2629
    { 0, eString },  //                               U+262A
    { 0, eString },  //                               U+262B
    { 0, eString },  //                               U+262C
    { 0, eString },  //                               U+262D
    { 0, eString },  //                               U+262E
    { 0, eString },  //                               U+262F
    { 0, eString },  //                               U+2630
    { 0, eString },  //                               U+2631
    { 0, eString },  //                               U+2632
    { 0, eString },  //                               U+2633
    { 0, eString },  //                               U+2634
    { 0, eString },  //                               U+2635
    { 0, eString },  //                               U+2636
    { 0, eString },  //                               U+2637
    { 0, eString },  //                               U+2638
    { 0, eString },  //                               U+2639
    { 0, eString },  //                               U+263A
    { 0, eString },  //                               U+263B
    { 0, eString },  //                               U+263C
    { 0, eString },  //                               U+263D
    { 0, eString },  //                               U+263E
    { 0, eString },  //                               U+263F
    { "female symbol", eString },  // old dictionary     U+2640
    { 0, eString },  //                               U+2641
    { "male symbol", eString },  // old dictionary       U+2642
    { 0, eString },  //                               U+2643
    { 0, eString },  //                               U+2644
    { 0, eString },  //                               U+2645
    { 0, eString },  //                               U+2646
    { 0, eString },  //                               U+2647
    { 0, eString },  //                               U+2648
    { 0, eString },  //                               U+2649
    { 0, eString },  //                               U+264A
    { 0, eString },  //                               U+264B
    { 0, eString },  //                               U+264C
    { 0, eString },  //                               U+264D
    { 0, eString },  //                               U+264E
    { 0, eString },  //                               U+264F
    { 0, eString },  //                               U+2650
    { 0, eString },  //                               U+2651
    { 0, eString },  //                               U+2652
    { 0, eString },  //                               U+2653
    { 0, eString },  //                               U+2654
    { 0, eString },  //                               U+2655
    { 0, eString },  //                               U+2656
    { 0, eString },  //                               U+2657
    { 0, eString },  //                               U+2658
    { 0, eString },  //                               U+2659
    { 0, eString },  //                               U+265A
    { 0, eString },  //                               U+265B
    { 0, eString },  //                               U+265C
    { 0, eString },  //                               U+265D
    { 0, eString },  //                               U+265E
    { 0, eString },  //                               U+265F
    { "spades", eString },  // old dictionary            U+2660
    { "heart", eString },  // old dictionary             U+2661
    { 0, eString },  //                               U+2662
    { "club suit symbol", eString },  // old dictionary  U+2663
    { 0, eString },  //                               U+2664
    { 0, eString },  //                               U+2665
    { "diamond", eString },  // old dictionary           U+2666
    { 0, eString },  //                               U+2667
    { 0, eString },  //                               U+2668
    { 0, eString },  //                               U+2669
    { "music note", eString },  // old dictionary        U+266A
    { 0, eString },  //                               U+266B
    { 0, eString },  //                               U+266C
    { "musical flat", eString },  // old dictionary      U+266D
    { " music natural", eString },  // old dictionary    U+266E
    { "musical sharp", eString },  // old dictionary     U+266F
    { 0, eString },  //                               U+2670
    { 0, eString },  //                               U+2671
    { 0, eString },  //                               U+2672
    { 0, eString },  //                               U+2673
    { 0, eString },  //                               U+2674
    { 0, eString },  //                               U+2675
    { 0, eString },  //                               U+2676
    { 0, eString },  //                               U+2677
    { 0, eString },  //                               U+2678
    { 0, eString },  //                               U+2679
    { 0, eString },  //                               U+267A
    { 0, eString },  //                               U+267B
    { 0, eString },  //                               U+267C
    { 0, eString },  //                               U+267D
    { 0, eString },  //                               U+267E
    { 0, eString },  //                               U+267F
    { 0, eString },  //                               U+2680
    { 0, eString },  //                               U+2681
    { 0, eString },  //                               U+2682
    { 0, eString },  //                               U+2683
    { 0, eString },  //                               U+2684
    { 0, eString },  //                               U+2685
    { 0, eString },  //                               U+2686
    { 0, eString },  //                               U+2687
    { 0, eString },  //                               U+2688
    { 0, eString },  //                               U+2689
    { 0, eString },  //                               U+268A
    { 0, eString },  //                               U+268B
    { 0, eString },  //                               U+268C
    { 0, eString },  //                               U+268D
    { 0, eString },  //                               U+268E
    { 0, eString },  //                               U+268F
    { 0, eString },  //                               U+2690
    { 0, eString },  //                               U+2691
    { 0, eString },  //                               U+2692
    { 0, eString },  //                               U+2693
    { 0, eString },  //                               U+2694
    { 0, eString },  //                               U+2695
    { 0, eString },  //                               U+2696
    { 0, eString },  //                               U+2697
    { 0, eString },  //                               U+2698
    { 0, eString },  //                               U+2699
    { 0, eString },  //                               U+269A
    { 0, eString },  //                               U+269B
    { 0, eString },  //                               U+269C
    { 0, eString },  //                               U+269D
    { 0, eString },  //                               U+269E
    { 0, eString },  //                               U+269F
    { 0, eString },  //                               U+26A0
    { 0, eString },  //                               U+26A1
    { 0, eString },  //                               U+26A2
    { 0, eString },  //                               U+26A3
    { 0, eString },  //                               U+26A4
    { 0, eString },  //                               U+26A5
    { 0, eString },  //                               U+26A6
    { 0, eString },  //                               U+26A7
    { 0, eString },  //                               U+26A8
    { 0, eString },  //                               U+26A9
    { 0, eString },  //                               U+26AA
    { 0, eString },  //                               U+26AB
    { 0, eString },  //                               U+26AC
    { 0, eString },  //                               U+26AD
    { 0, eString },  //                               U+26AE
    { 0, eString },  //                               U+26AF
    { 0, eString },  //                               U+26B0
    { 0, eString },  //                               U+26B1
    { 0, eString },  //                               U+26B2
    { 0, eString },  //                               U+26B3
    { 0, eString },  //                               U+26B4
    { 0, eString },  //                               U+26B5
    { 0, eString },  //                               U+26B6
    { 0, eString },  //                               U+26B7
    { 0, eString },  //                               U+26B8
    { 0, eString },  //                               U+26B9
    { 0, eString },  //                               U+26BA
    { 0, eString },  //                               U+26BB
    { 0, eString },  //                               U+26BC
    { 0, eString },  //                               U+26BD
    { 0, eString },  //                               U+26BE
    { 0, eString },  //                               U+26BF
    { 0, eString },  //                               U+26C0
    { 0, eString },  //                               U+26C1
    { 0, eString },  //                               U+26C2
    { 0, eString },  //                               U+26C3
    { 0, eString },  //                               U+26C4
    { 0, eString },  //                               U+26C5
    { 0, eString },  //                               U+26C6
    { 0, eString },  //                               U+26C7
    { 0, eString },  //                               U+26C8
    { 0, eString },  //                               U+26C9
    { 0, eString },  //                               U+26CA
    { 0, eString },  //                               U+26CB
    { 0, eString },  //                               U+26CC
    { 0, eString },  //                               U+26CD
    { 0, eString },  //                               U+26CE
    { 0, eString },  //                               U+26CF
    { 0, eString },  //                               U+26D0
    { 0, eString },  //                               U+26D1
    { 0, eString },  //                               U+26D2
    { 0, eString },  //                               U+26D3
    { 0, eString },  //                               U+26D4
    { 0, eString },  //                               U+26D5
    { 0, eString },  //                               U+26D6
    { 0, eString },  //                               U+26D7
    { 0, eString },  //                               U+26D8
    { 0, eString },  //                               U+26D9
    { 0, eString },  //                               U+26DA
    { 0, eString },  //                               U+26DB
    { 0, eString },  //                               U+26DC
    { 0, eString },  //                               U+26DD
    { 0, eString },  //                               U+26DE
    { 0, eString },  //                               U+26DF
    { 0, eString },  //                               U+26E0
    { 0, eString },  //                               U+26E1
    { 0, eString },  //                               U+26E2
    { 0, eString },  //                               U+26E3
    { 0, eString },  //                               U+26E4
    { 0, eString },  //                               U+26E5
    { 0, eString },  //                               U+26E6
    { 0, eString },  //                               U+26E7
    { 0, eString },  //                               U+26E8
    { 0, eString },  //                               U+26E9
    { 0, eString },  //                               U+26EA
    { 0, eString },  //                               U+26EB
    { 0, eString },  //                               U+26EC
    { 0, eString },  //                               U+26ED
    { 0, eString },  //                               U+26EE
    { 0, eString },  //                               U+26EF
    { 0, eString },  //                               U+26F0
    { 0, eString },  //                               U+26F1
    { 0, eString },  //                               U+26F2
    { 0, eString },  //                               U+26F3
    { 0, eString },  //                               U+26F4
    { 0, eString },  //                               U+26F5
    { 0, eString },  //                               U+26F6
    { 0, eString },  //                               U+26F7
    { 0, eString },  //                               U+26F8
    { 0, eString },  //                               U+26F9
    { 0, eString },  //                               U+26FA
    { 0, eString },  //                               U+26FB
    { 0, eString },  //                               U+26FC
    { 0, eString },  //                               U+26FD
    { 0, eString },  //                               U+26FE
    { 0, eString },  //                               U+26FF
};

/*
 * ==========================================================================
 * $Log$
 * Revision 1.1  2004/05/06 18:21:26  gouriano
 * Imported from pubmed/xmldb
 *
 * ==========================================================================
 */
