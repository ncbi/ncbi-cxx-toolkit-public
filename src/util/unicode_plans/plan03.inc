/*  $Id$
 * ==========================================================================
 *
 *                            PUBLIC DOMAIN NOTICE
 *               National Center for Biotechnology Information
 *
 *  This software/database is a "United States Government Work" under the
 *  terms of the United States Copyright Act.  It was written as part of
 *  the author's official duties as a United States Government employee and
 *  thus cannot be copyrighted.  This software/database is freely available
 *  to the public for use. The National Library of Medicine and the U.S.
 *  Government have not placed any restriction on its use or reproduction.
 *
 *  Although all reasonable efforts have been taken to ensure the accuracy
 *  and reliability of the software and data, the NLM and the U.S.
 *  Government do not and cannot warrant the performance or results that
 *  may be obtained by using this software or data. The NLM and the U.S.
 *  Government disclaim all warranties, express or implied, including
 *  warranties of performance, merchantability or fitness for any particular
 *  purpose.
 *
 *  Please cite the author in any work or product based on this material.
 *
 * ==========================================================================
 *
 * Author: Aleksey Vinokurov
 *
 * File Description:
 *    Unicode transformation library
 *    Plan 03
 *
 */

static TUnicodePlan s_Plan_03h = {
    { "", eString },  //                         U+0300
    { "", eString },  //                         U+0301
    { "", eString },  //                         U+0302
    { "", eString },  //                         U+0303
    { "", eString },  //                         U+0304
    { "", eString },  //                         U+0305
    { "", eString },  //                         U+0306
    { "", eString },  //                         U+0307
    { "", eString },  //                         U+0308
    { "", eString },  //                         U+0309
    { "", eString },  //                         U+030A
    { "", eString },  //                         U+030B
    { "", eString },  //                         U+030C
    { "", eString },  //                         U+030D
    { "", eString },  //                         U+030E
    { "", eString },  //                         U+030F
    { "", eString },  //                         U+0310
    { "", eString },  //                         U+0311
    { "", eString },  //                         U+0312
    { "", eString },  //                         U+0313
    { "", eString },  //                         U+0314
    { "", eString },  //                         U+0315
    { "", eString },  //                         U+0316
    { "", eString },  //                         U+0317
    { "", eString },  //                         U+0318
    { "", eString },  //                         U+0319
    { "", eString },  //                         U+031A
    { "", eString },  //                         U+031B
    { "", eString },  //                         U+031C
    { "", eString },  //                         U+031D
    { "", eString },  //                         U+031E
    { "", eString },  //                         U+031F
    { "", eString },  //                         U+0320
    { "", eString },  //                         U+0321
    { "", eString },  //                         U+0322
    { "", eString },  //                         U+0323
    { "", eString },  //                         U+0324
    { "", eString },  //                         U+0325
    { "", eString },  //                         U+0326
    { "", eString },  //                         U+0327
    { "", eString },  //                         U+0328
    { "", eString },  //                         U+0329
    { "", eString },  //                         U+032A
    { "", eString },  //                         U+032B
    { "", eString },  //                         U+032C
    { "", eString },  //                         U+032D
    { "", eString },  //                         U+032E
    { "", eString },  //                         U+032F
    { "", eString },  //                         U+0330
    { "", eString },  //                         U+0331
    { "", eString },  //                         U+0332
    { "", eString },  //                         U+0333
    { "", eString },  //                         U+0334
    { "", eString },  //                         U+0335
    { "", eString },  //                         U+0336
    { "", eString },  //                         U+0337
    { "", eString },  //                         U+0338
    { "", eString },  //                         U+0339
    { "", eString },  //                         U+033A
    { "", eString },  //                         U+033B
    { "", eString },  //                         U+033C
    { "", eString },  //                         U+033D
    { "", eString },  //                         U+033E
    { "", eString },  //                         U+033F
    { "", eString },  //                         U+0340
    { "", eString },  //                         U+0341
    { "", eString },  //                         U+0342
    { "", eString },  //                         U+0343
    { "", eString },  //                         U+0344
    { "", eString },  //                         U+0345
    { "", eString },  //                         U+0346
    { "", eString },  //                         U+0347
    { "", eString },  //                         U+0348
    { "", eString },  //                         U+0349
    { "", eString },  //                         U+034A
    { "", eString },  //                         U+034B
    { "", eString },  //                         U+034C
    { "", eString },  //                         U+034D
    { "", eString },  //                         U+034E
    { "", eString },  //                         U+034F
    { "", eString },  //                         U+0350
    { "", eString },  //                         U+0351
    { "", eString },  //                         U+0352
    { "", eString },  //                         U+0353
    { "", eString },  //                         U+0354
    { "", eString },  //                         U+0355
    { "", eString },  //                         U+0356
    { "", eString },  //                         U+0357
    { "", eString },  //                         U+0358
    { "", eString },  //                         U+0359
    { "", eString },  //                         U+035A
    { "", eString },  //                         U+035B
    { "", eString },  //                         U+035C
    { "", eString },  //                         U+035D
    { "", eString },  //                         U+035E
    { "", eString },  //                         U+035F
    { "", eString },  //                         U+0360
    { "", eString },  //                         U+0361
    { "", eString },  //                         U+0362
    { "", eString },  //                         U+0363
    { "", eString },  //                         U+0364
    { "", eString },  //                         U+0365
    { "", eString },  //                         U+0366
    { "", eString },  //                         U+0367
    { "", eString },  //                         U+0368
    { "", eString },  //                         U+0369
    { "", eString },  //                         U+036A
    { "", eString },  //                         U+036B
    { "", eString },  //                         U+036C
    { "", eString },  //                         U+036D
    { "", eString },  //                         U+036E
    { "", eString },  //                         U+036F
    { 0, eString },  //                       U+0370
    { 0, eString },  //                       U+0371
    { 0, eString },  //                       U+0372
    { 0, eString },  //                       U+0373
    { 0, eString },  //                       U+0374
    { 0, eString },  //                       U+0375
    { 0, eString },  //                       U+0376
    { 0, eString },  //                       U+0377
    { 0, eString },  //                       U+0378
    { 0, eString },  //                       U+0379
    { 0, eString },  //                       U+037A
    { 0, eString },  //                       U+037B
    { 0, eString },  //                       U+037C
    { 0, eString },  //                       U+037D
    { 0, eString },  //                       U+037E
    { 0, eString },  //                       U+037F
    { 0, eString },  //                       U+0380
    { 0, eString },  //                       U+0381
    { 0, eString },  //                       U+0382
    { 0, eString },  //                       U+0383
    { 0, eString },  //                       U+0384
    { 0, eString },  //                       U+0385
    { "Alpha", eString },  // old dictionary     U+0386
    { 0, eString },  //                       U+0387
    { "Epsilon", eString },  // old dictionary   U+0388
    { "Eta", eString },  // old dictionary       U+0389
    { "Iota", eString },  // old dictionary      U+038A
    { 0, eString },  //                       U+038B
    { "Omicron", eString },  // old dictionary   U+038C
    { 0, eString },  //                       U+038D
    { "Upsilon", eString },  // old dictionary   U+038E
    { "Omega", eString },  // old dictionary     U+038F
    { "iota", eString },  // old dictionary      U+0390
    { "Alpha", eString },  // old dictionary     U+0391
    { "Beta", eString },  // old dictionary      U+0392
    { "Gamma", eString },  // old dictionary     U+0393
    { "Delta", eString },  // old dictionary     U+0394
    { "Epsilon", eString },  // old dictionary   U+0395
    { "Zeta", eString },  // old dictionary      U+0396
    { "Eta", eString },  // old dictionary       U+0397
    { "Theta", eString },  // old dictionary     U+0398
    { "Iota", eString },  // old dictionary      U+0399
    { "Kappa", eString },  // old dictionary     U+039A
    { "Lambda", eString },  // old dictionary    U+039B
    { "Mu", eString },  //                       U+039C
    { "Nu", eString },  // old dictionary        U+039D
    { "Xi", eString },  // old dictionary        U+039E
    { "Omicron", eString },  // old dictionary   U+039F
    { "Pi", eString },  // old dictionary        U+03A0
    { "Rho", eString },  // old dictionary       U+03A1
    { 0, eString },  //                       U+03A2
    { "Sigma", eString },  // old dictionary     U+03A3
    { "Tau", eString },  // old dictionary       U+03A4
    { "Upsilon", eString },  // old dictionary   U+03A5
    { "Phi", eString },  // old dictionary       U+03A6
    { "Chi", eString },  // old dictionary       U+03A7
    { "Psi", eString },  // old dictionary       U+03A8
    { "Omega", eString },  // old dictionary     U+03A9
    { "Iota", eString },  // old dictionary      U+03AA
    { "Upsilon", eString },  // old dictionary   U+03AB
    { "alpha", eString },  // old dictionary     U+03AC
    { "epsilon", eString },  // old dictionary   U+03AD
    { "eta", eString },  // old dictionary       U+03AE
    { "iota", eString },  // old dictionary      U+03AF
    { "upsilon", eString },  // old dictionary   U+03B0
    { "alpha", eString },  // old dictionary     U+03B1
    { "beta", eString },  // old dictionary      U+03B2
    { "gamma", eString },  // old dictionary     U+03B3
    { "delta", eString },  // old dictionary     U+03B4
    { "epsilon", eString },  // old dictionary   U+03B5
    { "zeta", eString },  // old dictionary      U+03B6
    { "eta", eString },  // old dictionary       U+03B7
    { "theta;", eString },  // old dictionary    U+03B8
    { "iota", eString },  // old dictionary      U+03B9
    { "kappa", eString },  // old dictionary     U+03BA
    { "lambda", eString },  // old dictionary    U+03BB
    { "mu", eString },  //                       U+03BC
    { "nu", eString },  // old dictionary        U+03BD
    { "xi", eString },  // old dictionary        U+03BE
    { "omicron", eString },  // old dictionary   U+03BF
    { "pi", eString },  // old dictionary        U+03C0
    { "rho", eString },  // old dictionary       U+03C1
    { "varsigma", eString },  // old dictionary  U+03C2
    { "sigma", eString },  // old dictionary     U+03C3
    { "tau", eString },  // old dictionary       U+03C4
    { "upsilon", eString },  // old dictionary   U+03C5
    { "phi", eString },  //                      U+03C6
    { "chi", eString },  // old dictionary       U+03C7
    { "psi", eString },  // old dictionary       U+03C8
    { "omega", eString },  // old dictionary     U+03C9
    { "iota", eString },  // old dictionary      U+03CA
    { "upsilon", eString },  // old dictionary   U+03CB
    { "omicron", eString },  // old dictionary   U+03CC
    { "upsilon", eString },  // old dictionary   U+03CD
    { "omega", eString },  // old dictionary     U+03CE
    { 0, eString },  //                       U+03CF
    { 0, eString },  //                       U+03D0
    { "vartheta", eString },  // old dictionary  U+03D1
    { "Upsilon", eString },  // old dictionary   U+03D2
    { 0, eString },  //                       U+03D3
    { 0, eString },  //                       U+03D4
    { "varphi", eString },  // old dictionary    U+03D5
    { "varpi", eString },  // old dictionary     U+03D6
    { 0, eString },  //                       U+03D7
    { 0, eString },  //                       U+03D8
    { 0, eString },  //                       U+03D9
    { 0, eString },  //                       U+03DA
    { 0, eString },  //                       U+03DB
    { "digamma", eString },  //                  U+03DC
    { "digamma", eString },  // old dictionary   U+03DD
    { 0, eString },  //                       U+03DE
    { 0, eString },  //                       U+03DF
    { 0, eString },  //                       U+03E0
    { 0, eString },  //                       U+03E1
    { 0, eString },  //                       U+03E2
    { 0, eString },  //                       U+03E3
    { 0, eString },  //                       U+03E4
    { 0, eString },  //                       U+03E5
    { 0, eString },  //                       U+03E6
    { 0, eString },  //                       U+03E7
    { 0, eString },  //                       U+03E8
    { 0, eString },  //                       U+03E9
    { 0, eString },  //                       U+03EA
    { 0, eString },  //                       U+03EB
    { 0, eString },  //                       U+03EC
    { 0, eString },  //                       U+03ED
    { 0, eString },  //                       U+03EE
    { 0, eString },  //                       U+03EF
    { "varkappa", eString },  // old dictionary  U+03F0
    { "varrho", eString },  // old dictionary    U+03F1
    { 0, eString },  //                       U+03F2
    { 0, eString },  //                       U+03F3
    { 0, eString },  //                       U+03F4
    { 0, eString },  //                       U+03F5
    { 0, eString },  //                       U+03F6
    { 0, eString },  //                       U+03F7
    { 0, eString },  //                       U+03F8
    { 0, eString },  //                       U+03F9
    { 0, eString },  //                       U+03FA
    { 0, eString },  //                       U+03FB
    { 0, eString },  //                       U+03FC
    { 0, eString },  //                       U+03FD
    { 0, eString },  //                       U+03FE
    { 0, eString },  //                       U+03FF
};

/*
 * ==========================================================================
 * $Log$
 * Revision 1.1  2004/05/06 18:21:26  gouriano
 * Imported from pubmed/xmldb
 *
 * ==========================================================================
 */
