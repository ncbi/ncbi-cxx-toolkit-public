/*  $Id$
 * ==========================================================================
 *
 *                            PUBLIC DOMAIN NOTICE
 *               National Center for Biotechnology Information
 *
 *  This software/database is a "United States Government Work" under the
 *  terms of the United States Copyright Act.  It was written as part of
 *  the author's official duties as a United States Government employee and
 *  thus cannot be copyrighted.  This software/database is freely available
 *  to the public for use. The National Library of Medicine and the U.S.
 *  Government have not placed any restriction on its use or reproduction.
 *
 *  Although all reasonable efforts have been taken to ensure the accuracy
 *  and reliability of the software and data, the NLM and the U.S.
 *  Government do not and cannot warrant the performance or results that
 *  may be obtained by using this software or data. The NLM and the U.S.
 *  Government disclaim all warranties, express or implied, including
 *  warranties of performance, merchantability or fitness for any particular
 *  purpose.
 *
 *  Please cite the author in any work or product based on this material.
 *
 * ==========================================================================
 *
 * Author: Aleksey Vinokurov
 *
 * File Description:
 *    Unicode transformation library
 *    Plan E6
 *
 */

static TUnicodePlan s_Plan_E6h = {
    { 0, eString },  // U+E600
    { 0, eString },  // U+E601
    { 0, eString },  // U+E602
    { 0, eString },  // U+E603
    { 0, eString },  // U+E604
    { 0, eString },  // U+E605
    { 0, eString },  // U+E606
    { 0, eString },  // U+E607
    { 0, eString },  // U+E608
    { 0, eString },  // U+E609
    { 0, eString },  // U+E60A
    { 0, eString },  // U+E60B
    { 0, eString },  // U+E60C
    { 0, eString },  // U+E60D
    { 0, eString },  // U+E60E
    { 0, eString },  // U+E60F
    { 0, eString },  // U+E610
    { 0, eString },  // U+E611
    { 0, eString },  // U+E612
    { 0, eString },  // U+E613
    { 0, eString },  // U+E614
    { 0, eString },  // U+E615
    { 0, eString },  // U+E616
    { 0, eString },  // U+E617
    { 0, eString },  // U+E618
    { 0, eString },  // U+E619
    { 0, eString },  // U+E61A
    { 0, eString },  // U+E61B
    { 0, eString },  // U+E61C
    { 0, eString },  // U+E61D
    { 0, eString },  // U+E61E
    { 0, eString },  // U+E61F
    { 0, eString },  // U+E620
    { 0, eString },  // U+E621
    { 0, eString },  // U+E622
    { 0, eString },  // U+E623
    { 0, eString },  // U+E624
    { 0, eString },  // U+E625
    { 0, eString },  // U+E626
    { 0, eString },  // U+E627
    { 0, eString },  // U+E628
    { 0, eString },  // U+E629
    { 0, eString },  // U+E62A
    { 0, eString },  // U+E62B
    { 0, eString },  // U+E62C
    { 0, eString },  // U+E62D
    { 0, eString },  // U+E62E
    { 0, eString },  // U+E62F
    { 0, eString },  // U+E630
    { 0, eString },  // U+E631
    { 0, eString },  // U+E632
    { 0, eString },  // U+E633
    { 0, eString },  // U+E634
    { 0, eString },  // U+E635
    { 0, eString },  // U+E636
    { 0, eString },  // U+E637
    { 0, eString },  // U+E638
    { 0, eString },  // U+E639
    { 0, eString },  // U+E63A
    { 0, eString },  // U+E63B
    { 0, eString },  // U+E63C
    { 0, eString },  // U+E63D
    { 0, eString },  // U+E63E
    { 0, eString },  // U+E63F
    { 0, eString },  // U+E640
    { 0, eString },  // U+E641
    { 0, eString },  // U+E642
    { 0, eString },  // U+E643
    { 0, eString },  // U+E644
    { 0, eString },  // U+E645
    { 0, eString },  // U+E646
    { 0, eString },  // U+E647
    { 0, eString },  // U+E648
    { 0, eString },  // U+E649
    { 0, eString },  // U+E64A
    { 0, eString },  // U+E64B
    { 0, eString },  // U+E64C
    { 0, eString },  // U+E64D
    { 0, eString },  // U+E64E
    { 0, eString },  // U+E64F
    { 0, eString },  // U+E650
    { 0, eString },  // U+E651
    { 0, eString },  // U+E652
    { 0, eString },  // U+E653
    { 0, eString },  // U+E654
    { 0, eString },  // U+E655
    { 0, eString },  // U+E656
    { 0, eString },  // U+E657
    { 0, eString },  // U+E658
    { 0, eString },  // U+E659
    { 0, eString },  // U+E65A
    { 0, eString },  // U+E65B
    { 0, eString },  // U+E65C
    { 0, eString },  // U+E65D
    { 0, eString },  // U+E65E
    { 0, eString },  // U+E65F
    { 0, eString },  // U+E660
    { 0, eString },  // U+E661
    { 0, eString },  // U+E662
    { 0, eString },  // U+E663
    { 0, eString },  // U+E664
    { 0, eString },  // U+E665
    { 0, eString },  // U+E666
    { 0, eString },  // U+E667
    { 0, eString },  // U+E668
    { 0, eString },  // U+E669
    { 0, eString },  // U+E66A
    { 0, eString },  // U+E66B
    { 0, eString },  // U+E66C
    { 0, eString },  // U+E66D
    { 0, eString },  // U+E66E
    { 0, eString },  // U+E66F
    { 0, eString },  // U+E670
    { 0, eString },  // U+E671
    { 0, eString },  // U+E672
    { 0, eString },  // U+E673
    { 0, eString },  // U+E674
    { 0, eString },  // U+E675
    { 0, eString },  // U+E676
    { 0, eString },  // U+E677
    { 0, eString },  // U+E678
    { 0, eString },  // U+E679
    { 0, eString },  // U+E67A
    { 0, eString },  // U+E67B
    { 0, eString },  // U+E67C
    { 0, eString },  // U+E67D
    { 0, eString },  // U+E67E
    { 0, eString },  // U+E67F
    { 0, eString },  // U+E680
    { 0, eString },  // U+E681
    { 0, eString },  // U+E682
    { 0, eString },  // U+E683
    { 0, eString },  // U+E684
    { 0, eString },  // U+E685
    { 0, eString },  // U+E686
    { 0, eString },  // U+E687
    { 0, eString },  // U+E688
    { 0, eString },  // U+E689
    { 0, eString },  // U+E68A
    { 0, eString },  // U+E68B
    { 0, eString },  // U+E68C
    { 0, eString },  // U+E68D
    { 0, eString },  // U+E68E
    { 0, eString },  // U+E68F
    { 0, eString },  // U+E690
    { 0, eString },  // U+E691
    { 0, eString },  // U+E692
    { 0, eString },  // U+E693
    { 0, eString },  // U+E694
    { 0, eString },  // U+E695
    { 0, eString },  // U+E696
    { 0, eString },  // U+E697
    { 0, eString },  // U+E698
    { 0, eString },  // U+E699
    { 0, eString },  // U+E69A
    { 0, eString },  // U+E69B
    { 0, eString },  // U+E69C
    { 0, eString },  // U+E69D
    { 0, eString },  // U+E69E
    { 0, eString },  // U+E69F
    { 0, eString },  // U+E6A0
    { 0, eString },  // U+E6A1
    { 0, eString },  // U+E6A2
    { 0, eString },  // U+E6A3
    { 0, eString },  // U+E6A4
    { 0, eString },  // U+E6A5
    { 0, eString },  // U+E6A6
    { 0, eString },  // U+E6A7
    { 0, eString },  // U+E6A8
    { 0, eString },  // U+E6A9
    { 0, eString },  // U+E6AA
    { 0, eString },  // U+E6AB
    { 0, eString },  // U+E6AC
    { 0, eString },  // U+E6AD
    { 0, eString },  // U+E6AE
    { 0, eString },  // U+E6AF
    { 0, eString },  // U+E6B0
    { 0, eString },  // U+E6B1
    { 0, eString },  // U+E6B2
    { 0, eString },  // U+E6B3
    { 0, eString },  // U+E6B4
    { 0, eString },  // U+E6B5
    { 0, eString },  // U+E6B6
    { 0, eString },  // U+E6B7
    { 0, eString },  // U+E6B8
    { 0, eString },  // U+E6B9
    { 0, eString },  // U+E6BA
    { 0, eString },  // U+E6BB
    { 0, eString },  // U+E6BC
    { 0, eString },  // U+E6BD
    { 0, eString },  // U+E6BE
    { 0, eString },  // U+E6BF
    { 0, eString },  // U+E6C0
    { 0, eString },  // U+E6C1
    { 0, eString },  // U+E6C2
    { 0, eString },  // U+E6C3
    { 0, eString },  // U+E6C4
    { 0, eString },  // U+E6C5
    { 0, eString },  // U+E6C6
    { 0, eString },  // U+E6C7
    { 0, eString },  // U+E6C8
    { 0, eString },  // U+E6C9
    { 0, eString },  // U+E6CA
    { 0, eString },  // U+E6CB
    { 0, eString },  // U+E6CC
    { 0, eString },  // U+E6CD
    { 0, eString },  // U+E6CE
    { 0, eString },  // U+E6CF
    { 0, eString },  // U+E6D0
    { 0, eString },  // U+E6D1
    { 0, eString },  // U+E6D2
    { 0, eString },  // U+E6D3
    { 0, eString },  // U+E6D4
    { 0, eString },  // U+E6D5
    { 0, eString },  // U+E6D6
    { 0, eString },  // U+E6D7
    { 0, eString },  // U+E6D8
    { 0, eString },  // U+E6D9
    { 0, eString },  // U+E6DA
    { 0, eString },  // U+E6DB
    { 0, eString },  // U+E6DC
    { 0, eString },  // U+E6DD
    { 0, eString },  // U+E6DE
    { 0, eString },  // U+E6DF
    { 0, eString },  // U+E6E0
    { 0, eString },  // U+E6E1
    { 0, eString },  // U+E6E2
    { 0, eString },  // U+E6E3
    { 0, eString },  // U+E6E4
    { 0, eString },  // U+E6E5
    { 0, eString },  // U+E6E6
    { 0, eString },  // U+E6E7
    { 0, eString },  // U+E6E8
    { 0, eString },  // U+E6E9
    { 0, eString },  // U+E6EA
    { 0, eString },  // U+E6EB
    { 0, eString },  // U+E6EC
    { 0, eString },  // U+E6ED
    { 0, eString },  // U+E6EE
    { 0, eString },  // U+E6EF
    { 0, eString },  // U+E6F0
    { 0, eString },  // U+E6F1
    { 0, eString },  // U+E6F2
    { 0, eString },  // U+E6F3
    { 0, eString },  // U+E6F4
    { 0, eString },  // U+E6F5
    { 0, eString },  // U+E6F6
    { 0, eString },  // U+E6F7
    { 0, eString },  // U+E6F8
    { 0, eString },  // U+E6F9
    { 0, eString },  // U+E6FA
    { 0, eString },  // U+E6FB
    { 0, eString },  // U+E6FC
    { 0, eString },  // U+E6FD
    { 0, eString },  // U+E6FE
    { 0, eString },  // U+E6FF
};

/*
 * ==========================================================================
 * $Log$
 * Revision 1.1  2004/05/06 18:21:26  gouriano
 * Imported from pubmed/xmldb
 *
 * ==========================================================================
 */
