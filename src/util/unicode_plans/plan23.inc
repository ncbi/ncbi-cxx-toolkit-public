/*  $Id$
 * ==========================================================================
 *
 *                            PUBLIC DOMAIN NOTICE
 *               National Center for Biotechnology Information
 *
 *  This software/database is a "United States Government Work" under the
 *  terms of the United States Copyright Act.  It was written as part of
 *  the author's official duties as a United States Government employee and
 *  thus cannot be copyrighted.  This software/database is freely available
 *  to the public for use. The National Library of Medicine and the U.S.
 *  Government have not placed any restriction on its use or reproduction.
 *
 *  Although all reasonable efforts have been taken to ensure the accuracy
 *  and reliability of the software and data, the NLM and the U.S.
 *  Government do not and cannot warrant the performance or results that
 *  may be obtained by using this software or data. The NLM and the U.S.
 *  Government disclaim all warranties, express or implied, including
 *  warranties of performance, merchantability or fitness for any particular
 *  purpose.
 *
 *  Please cite the author in any work or product based on this material.
 *
 * ==========================================================================
 *
 * Author: Aleksey Vinokurov
 *
 * File Description:
 *    Unicode transformation library
 *    Plan 23
 *
 */

static TUnicodePlan s_Plan_23h = {
    { 0, eString },  //                                        U+2300
    { 0, eString },  //                                        U+2301
    { 0, eString },  //                                        U+2302
    { 0, eString },  //                                        U+2303
    { 0, eString },  //                                        U+2304
    { 0, eString },  //                                        U+2305
    { " log and, dbl bar", eString },  // old dictionary          U+2306
    { 0, eString },  //                                        U+2307
    { " left ceiling", eString },  // old dictionary              U+2308
    { " right ceiling", eString },  // old dictionary             U+2309
    { " left floor", eString },  // old dictionary                U+230A
    { " right floor", eString },  // old dictionary               U+230B
    { "downward right crop mark ", eString },  // old dictionary  U+230C
    { "downward left crop mark ", eString },  // old dictionary   U+230D
    { "upward right crop mark ", eString },  // old dictionary    U+230E
    { "upward left crop mark ", eString },  // old dictionary     U+230F
    { "reverse not", eString },  //                               U+2310
    { 0, eString },  //                                        U+2311
    { "profile of a line", eString },  //                         U+2312
    { "profile of a surface", eString },  //                      U+2313
    { 0, eString },  //                                        U+2314
    { "telephone recorder symbol", eString },  // old dictionary  U+2315
    { "register mark or target", eString },  // old dictionary    U+2316
    { 0, eString },  //                                        U+2317
    { 0, eString },  //                                        U+2318
    { 0, eString },  //                                        U+2319
    { 0, eString },  //                                        U+231A
    { 0, eString },  //                                        U+231B
    { " upper left corner", eString },  // old dictionary         U+231C
    { " upper right corner", eString },  // old dictionary        U+231D
    { " downward left corner", eString },  // old dictionary      U+231E
    { " downward right corner", eString },  // old dictionary     U+231F
    { 0, eString },  //                                        U+2320
    { 0, eString },  //                                        U+2321
    { " down curve", eString },  // old dictionary                U+2322
    { " up curve", eString },  // old dictionary                  U+2323
    { 0, eString },  //                                        U+2324
    { 0, eString },  //                                        U+2325
    { 0, eString },  //                                        U+2326
    { 0, eString },  //                                        U+2327
    { 0, eString },  //                                        U+2328
    { 0, eString },  //                                        U+2329
    { 0, eString },  //                                        U+232A
    { 0, eString },  //                                        U+232B
    { 0, eString },  //                                        U+232C
    { "cylindricity", eString },  //                              U+232D
    { "all-around profile", eString },  //                        U+232E
    { 0, eString },  //                                        U+232F
    { 0, eString },  //                                        U+2330
    { 0, eString },  //                                        U+2331
    { 0, eString },  //                                        U+2332
    { 0, eString },  //                                        U+2333
    { 0, eString },  //                                        U+2334
    { 0, eString },  //                                        U+2335
    { "top and bottom", eString },  //                            U+2336
    { 0, eString },  //                                        U+2337
    { 0, eString },  //                                        U+2338
    { 0, eString },  //                                        U+2339
    { 0, eString },  //                                        U+233A
    { 0, eString },  //                                        U+233B
    { 0, eString },  //                                        U+233C
    { 0, eString },  //                                        U+233D
    { 0, eString },  //                                        U+233E
    { 0, eString },  //                                        U+233F
    { 0, eString },  //                                        U+2340
    { 0, eString },  //                                        U+2341
    { 0, eString },  //                                        U+2342
    { 0, eString },  //                                        U+2343
    { 0, eString },  //                                        U+2344
    { 0, eString },  //                                        U+2345
    { 0, eString },  //                                        U+2346
    { 0, eString },  //                                        U+2347
    { 0, eString },  //                                        U+2348
    { 0, eString },  //                                        U+2349
    { 0, eString },  //                                        U+234A
    { 0, eString },  //                                        U+234B
    { 0, eString },  //                                        U+234C
    { 0, eString },  //                                        U+234D
    { 0, eString },  //                                        U+234E
    { 0, eString },  //                                        U+234F
    { 0, eString },  //                                        U+2350
    { 0, eString },  //                                        U+2351
    { 0, eString },  //                                        U+2352
    { 0, eString },  //                                        U+2353
    { 0, eString },  //                                        U+2354
    { 0, eString },  //                                        U+2355
    { 0, eString },  //                                        U+2356
    { 0, eString },  //                                        U+2357
    { 0, eString },  //                                        U+2358
    { 0, eString },  //                                        U+2359
    { 0, eString },  //                                        U+235A
    { 0, eString },  //                                        U+235B
    { 0, eString },  //                                        U+235C
    { 0, eString },  //                                        U+235D
    { 0, eString },  //                                        U+235E
    { 0, eString },  //                                        U+235F
    { 0, eString },  //                                        U+2360
    { 0, eString },  //                                        U+2361
    { 0, eString },  //                                        U+2362
    { 0, eString },  //                                        U+2363
    { 0, eString },  //                                        U+2364
    { 0, eString },  //                                        U+2365
    { 0, eString },  //                                        U+2366
    { 0, eString },  //                                        U+2367
    { 0, eString },  //                                        U+2368
    { 0, eString },  //                                        U+2369
    { 0, eString },  //                                        U+236A
    { 0, eString },  //                                        U+236B
    { 0, eString },  //                                        U+236C
    { 0, eString },  //                                        U+236D
    { 0, eString },  //                                        U+236E
    { 0, eString },  //                                        U+236F
    { 0, eString },  //                                        U+2370
    { 0, eString },  //                                        U+2371
    { 0, eString },  //                                        U+2372
    { 0, eString },  //                                        U+2373
    { 0, eString },  //                                        U+2374
    { 0, eString },  //                                        U+2375
    { 0, eString },  //                                        U+2376
    { 0, eString },  //                                        U+2377
    { 0, eString },  //                                        U+2378
    { 0, eString },  //                                        U+2379
    { 0, eString },  //                                        U+237A
    { 0, eString },  //                                        U+237B
    { 0, eString },  //                                        U+237C
    { 0, eString },  //                                        U+237D
    { 0, eString },  //                                        U+237E
    { 0, eString },  //                                        U+237F
    { 0, eString },  //                                        U+2380
    { 0, eString },  //                                        U+2381
    { 0, eString },  //                                        U+2382
    { 0, eString },  //                                        U+2383
    { 0, eString },  //                                        U+2384
    { 0, eString },  //                                        U+2385
    { 0, eString },  //                                        U+2386
    { 0, eString },  //                                        U+2387
    { 0, eString },  //                                        U+2388
    { 0, eString },  //                                        U+2389
    { 0, eString },  //                                        U+238A
    { 0, eString },  //                                        U+238B
    { 0, eString },  //                                        U+238C
    { 0, eString },  //                                        U+238D
    { 0, eString },  //                                        U+238E
    { 0, eString },  //                                        U+238F
    { 0, eString },  //                                        U+2390
    { 0, eString },  //                                        U+2391
    { 0, eString },  //                                        U+2392
    { 0, eString },  //                                        U+2393
    { 0, eString },  //                                        U+2394
    { 0, eString },  //                                        U+2395
    { 0, eString },  //                                        U+2396
    { 0, eString },  //                                        U+2397
    { 0, eString },  //                                        U+2398
    { 0, eString },  //                                        U+2399
    { 0, eString },  //                                        U+239A
    { 0, eString },  //                                        U+239B
    { 0, eString },  //                                        U+239C
    { 0, eString },  //                                        U+239D
    { 0, eString },  //                                        U+239E
    { 0, eString },  //                                        U+239F
    { 0, eString },  //                                        U+23A0
    { 0, eString },  //                                        U+23A1
    { 0, eString },  //                                        U+23A2
    { 0, eString },  //                                        U+23A3
    { 0, eString },  //                                        U+23A4
    { 0, eString },  //                                        U+23A5
    { 0, eString },  //                                        U+23A6
    { 0, eString },  //                                        U+23A7
    { 0, eString },  //                                        U+23A8
    { 0, eString },  //                                        U+23A9
    { 0, eString },  //                                        U+23AA
    { 0, eString },  //                                        U+23AB
    { 0, eString },  //                                        U+23AC
    { 0, eString },  //                                        U+23AD
    { 0, eString },  //                                        U+23AE
    { 0, eString },  //                                        U+23AF
    { 0, eString },  //                                        U+23B0
    { 0, eString },  //                                        U+23B1
    { 0, eString },  //                                        U+23B2
    { 0, eString },  //                                        U+23B3
    { 0, eString },  //                                        U+23B4
    { 0, eString },  //                                        U+23B5
    { 0, eString },  //                                        U+23B6
    { 0, eString },  //                                        U+23B7
    { 0, eString },  //                                        U+23B8
    { 0, eString },  //                                        U+23B9
    { 0, eString },  //                                        U+23BA
    { 0, eString },  //                                        U+23BB
    { 0, eString },  //                                        U+23BC
    { 0, eString },  //                                        U+23BD
    { 0, eString },  //                                        U+23BE
    { 0, eString },  //                                        U+23BF
    { 0, eString },  //                                        U+23C0
    { 0, eString },  //                                        U+23C1
    { 0, eString },  //                                        U+23C2
    { 0, eString },  //                                        U+23C3
    { 0, eString },  //                                        U+23C4
    { 0, eString },  //                                        U+23C5
    { 0, eString },  //                                        U+23C6
    { 0, eString },  //                                        U+23C7
    { 0, eString },  //                                        U+23C8
    { 0, eString },  //                                        U+23C9
    { 0, eString },  //                                        U+23CA
    { 0, eString },  //                                        U+23CB
    { 0, eString },  //                                        U+23CC
    { 0, eString },  //                                        U+23CD
    { 0, eString },  //                                        U+23CE
    { 0, eString },  //                                        U+23CF
    { 0, eString },  //                                        U+23D0
    { 0, eString },  //                                        U+23D1
    { 0, eString },  //                                        U+23D2
    { 0, eString },  //                                        U+23D3
    { 0, eString },  //                                        U+23D4
    { 0, eString },  //                                        U+23D5
    { 0, eString },  //                                        U+23D6
    { 0, eString },  //                                        U+23D7
    { 0, eString },  //                                        U+23D8
    { 0, eString },  //                                        U+23D9
    { 0, eString },  //                                        U+23DA
    { 0, eString },  //                                        U+23DB
    { 0, eString },  //                                        U+23DC
    { 0, eString },  //                                        U+23DD
    { 0, eString },  //                                        U+23DE
    { 0, eString },  //                                        U+23DF
    { 0, eString },  //                                        U+23E0
    { 0, eString },  //                                        U+23E1
    { 0, eString },  //                                        U+23E2
    { 0, eString },  //                                        U+23E3
    { 0, eString },  //                                        U+23E4
    { 0, eString },  //                                        U+23E5
    { 0, eString },  //                                        U+23E6
    { 0, eString },  //                                        U+23E7
    { 0, eString },  //                                        U+23E8
    { 0, eString },  //                                        U+23E9
    { 0, eString },  //                                        U+23EA
    { 0, eString },  //                                        U+23EB
    { 0, eString },  //                                        U+23EC
    { 0, eString },  //                                        U+23ED
    { 0, eString },  //                                        U+23EE
    { 0, eString },  //                                        U+23EF
    { 0, eString },  //                                        U+23F0
    { 0, eString },  //                                        U+23F1
    { 0, eString },  //                                        U+23F2
    { 0, eString },  //                                        U+23F3
    { 0, eString },  //                                        U+23F4
    { 0, eString },  //                                        U+23F5
    { 0, eString },  //                                        U+23F6
    { 0, eString },  //                                        U+23F7
    { 0, eString },  //                                        U+23F8
    { 0, eString },  //                                        U+23F9
    { 0, eString },  //                                        U+23FA
    { 0, eString },  //                                        U+23FB
    { 0, eString },  //                                        U+23FC
    { 0, eString },  //                                        U+23FD
    { 0, eString },  //                                        U+23FE
    { 0, eString },  //                                        U+23FF
};

/*
 * ==========================================================================
 * $Log$
 * Revision 1.1  2004/05/06 18:21:26  gouriano
 * Imported from pubmed/xmldb
 *
 * ==========================================================================
 */
