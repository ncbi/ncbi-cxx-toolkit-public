/*  $Id$
 * ==========================================================================
 *
 *                            PUBLIC DOMAIN NOTICE
 *               National Center for Biotechnology Information
 *
 *  This software/database is a "United States Government Work" under the
 *  terms of the United States Copyright Act.  It was written as part of
 *  the author's official duties as a United States Government employee and
 *  thus cannot be copyrighted.  This software/database is freely available
 *  to the public for use. The National Library of Medicine and the U.S.
 *  Government have not placed any restriction on its use or reproduction.
 *
 *  Although all reasonable efforts have been taken to ensure the accuracy
 *  and reliability of the software and data, the NLM and the U.S.
 *  Government do not and cannot warrant the performance or results that
 *  may be obtained by using this software or data. The NLM and the U.S.
 *  Government disclaim all warranties, express or implied, including
 *  warranties of performance, merchantability or fitness for any particular
 *  purpose.
 *
 *  Please cite the author in any work or product based on this material.
 *
 * ==========================================================================
 *
 * Author: Aleksey Vinokurov
 *
 * File Description:
 *    Unicode transformation library
 *    Plan 24
 *
 */

static TUnicodePlan s_Plan_24h = {
    { 0, eString },  //                          U+2400
    { 0, eString },  //                          U+2401
    { 0, eString },  //                          U+2402
    { 0, eString },  //                          U+2403
    { 0, eString },  //                          U+2404
    { 0, eString },  //                          U+2405
    { 0, eString },  //                          U+2406
    { 0, eString },  //                          U+2407
    { 0, eString },  //                          U+2408
    { 0, eString },  //                          U+2409
    { 0, eString },  //                          U+240A
    { 0, eString },  //                          U+240B
    { 0, eString },  //                          U+240C
    { 0, eString },  //                          U+240D
    { 0, eString },  //                          U+240E
    { 0, eString },  //                          U+240F
    { 0, eString },  //                          U+2410
    { 0, eString },  //                          U+2411
    { 0, eString },  //                          U+2412
    { 0, eString },  //                          U+2413
    { 0, eString },  //                          U+2414
    { 0, eString },  //                          U+2415
    { 0, eString },  //                          U+2416
    { 0, eString },  //                          U+2417
    { 0, eString },  //                          U+2418
    { 0, eString },  //                          U+2419
    { 0, eString },  //                          U+241A
    { 0, eString },  //                          U+241B
    { 0, eString },  //                          U+241C
    { 0, eString },  //                          U+241D
    { 0, eString },  //                          U+241E
    { 0, eString },  //                          U+241F
    { 0, eString },  //                          U+2420
    { 0, eString },  //                          U+2421
    { 0, eString },  //                          U+2422
    { " ", eString },  // old dictionary            U+2423
    { 0, eString },  //                          U+2424
    { 0, eString },  //                          U+2425
    { 0, eString },  //                          U+2426
    { 0, eString },  //                          U+2427
    { 0, eString },  //                          U+2428
    { 0, eString },  //                          U+2429
    { 0, eString },  //                          U+242A
    { 0, eString },  //                          U+242B
    { 0, eString },  //                          U+242C
    { 0, eString },  //                          U+242D
    { 0, eString },  //                          U+242E
    { 0, eString },  //                          U+242F
    { 0, eString },  //                          U+2430
    { 0, eString },  //                          U+2431
    { 0, eString },  //                          U+2432
    { 0, eString },  //                          U+2433
    { 0, eString },  //                          U+2434
    { 0, eString },  //                          U+2435
    { 0, eString },  //                          U+2436
    { 0, eString },  //                          U+2437
    { 0, eString },  //                          U+2438
    { 0, eString },  //                          U+2439
    { 0, eString },  //                          U+243A
    { 0, eString },  //                          U+243B
    { 0, eString },  //                          U+243C
    { 0, eString },  //                          U+243D
    { 0, eString },  //                          U+243E
    { 0, eString },  //                          U+243F
    { 0, eString },  //                          U+2440
    { 0, eString },  //                          U+2441
    { 0, eString },  //                          U+2442
    { 0, eString },  //                          U+2443
    { 0, eString },  //                          U+2444
    { 0, eString },  //                          U+2445
    { 0, eString },  //                          U+2446
    { 0, eString },  //                          U+2447
    { 0, eString },  //                          U+2448
    { 0, eString },  //                          U+2449
    { "\\", eString },  //                          U+244A
    { 0, eString },  //                          U+244B
    { 0, eString },  //                          U+244C
    { 0, eString },  //                          U+244D
    { 0, eString },  //                          U+244E
    { 0, eString },  //                          U+244F
    { 0, eString },  //                          U+2450
    { 0, eString },  //                          U+2451
    { 0, eString },  //                          U+2452
    { 0, eString },  //                          U+2453
    { 0, eString },  //                          U+2454
    { 0, eString },  //                          U+2455
    { 0, eString },  //                          U+2456
    { 0, eString },  //                          U+2457
    { 0, eString },  //                          U+2458
    { 0, eString },  //                          U+2459
    { 0, eString },  //                          U+245A
    { 0, eString },  //                          U+245B
    { 0, eString },  //                          U+245C
    { 0, eString },  //                          U+245D
    { 0, eString },  //                          U+245E
    { 0, eString },  //                          U+245F
    { "1 in circle", eString },  //                 U+2460
    { "2 in circle", eString },  //                 U+2461
    { "3 in circle", eString },  //                 U+2462
    { "4 in circle", eString },  //                 U+2463
    { 0, eString },  //                          U+2464
    { 0, eString },  //                          U+2465
    { 0, eString },  //                          U+2466
    { 0, eString },  //                          U+2467
    { 0, eString },  //                          U+2468
    { 0, eString },  //                          U+2469
    { 0, eString },  //                          U+246A
    { 0, eString },  //                          U+246B
    { 0, eString },  //                          U+246C
    { 0, eString },  //                          U+246D
    { 0, eString },  //                          U+246E
    { 0, eString },  //                          U+246F
    { 0, eString },  //                          U+2470
    { 0, eString },  //                          U+2471
    { 0, eString },  //                          U+2472
    { 0, eString },  //                          U+2473
    { 0, eString },  //                          U+2474
    { 0, eString },  //                          U+2475
    { 0, eString },  //                          U+2476
    { 0, eString },  //                          U+2477
    { 0, eString },  //                          U+2478
    { 0, eString },  //                          U+2479
    { 0, eString },  //                          U+247A
    { 0, eString },  //                          U+247B
    { 0, eString },  //                          U+247C
    { 0, eString },  //                          U+247D
    { 0, eString },  //                          U+247E
    { 0, eString },  //                          U+247F
    { 0, eString },  //                          U+2480
    { 0, eString },  //                          U+2481
    { 0, eString },  //                          U+2482
    { 0, eString },  //                          U+2483
    { 0, eString },  //                          U+2484
    { 0, eString },  //                          U+2485
    { 0, eString },  //                          U+2486
    { 0, eString },  //                          U+2487
    { 0, eString },  //                          U+2488
    { 0, eString },  //                          U+2489
    { 0, eString },  //                          U+248A
    { 0, eString },  //                          U+248B
    { 0, eString },  //                          U+248C
    { 0, eString },  //                          U+248D
    { 0, eString },  //                          U+248E
    { 0, eString },  //                          U+248F
    { 0, eString },  //                          U+2490
    { 0, eString },  //                          U+2491
    { 0, eString },  //                          U+2492
    { 0, eString },  //                          U+2493
    { 0, eString },  //                          U+2494
    { 0, eString },  //                          U+2495
    { 0, eString },  //                          U+2496
    { 0, eString },  //                          U+2497
    { 0, eString },  //                          U+2498
    { 0, eString },  //                          U+2499
    { 0, eString },  //                          U+249A
    { 0, eString },  //                          U+249B
    { 0, eString },  //                          U+249C
    { 0, eString },  //                          U+249D
    { 0, eString },  //                          U+249E
    { 0, eString },  //                          U+249F
    { 0, eString },  //                          U+24A0
    { 0, eString },  //                          U+24A1
    { 0, eString },  //                          U+24A2
    { 0, eString },  //                          U+24A3
    { 0, eString },  //                          U+24A4
    { 0, eString },  //                          U+24A5
    { 0, eString },  //                          U+24A6
    { 0, eString },  //                          U+24A7
    { 0, eString },  //                          U+24A8
    { 0, eString },  //                          U+24A9
    { 0, eString },  //                          U+24AA
    { 0, eString },  //                          U+24AB
    { 0, eString },  //                          U+24AC
    { 0, eString },  //                          U+24AD
    { 0, eString },  //                          U+24AE
    { 0, eString },  //                          U+24AF
    { 0, eString },  //                          U+24B0
    { 0, eString },  //                          U+24B1
    { 0, eString },  //                          U+24B2
    { 0, eString },  //                          U+24B3
    { 0, eString },  //                          U+24B4
    { 0, eString },  //                          U+24B5
    { 0, eString },  //                          U+24B6
    { 0, eString },  //                          U+24B7
    { 0, eString },  //                          U+24B8
    { 0, eString },  //                          U+24B9
    { 0, eString },  //                          U+24BA
    { 0, eString },  //                          U+24BB
    { 0, eString },  //                          U+24BC
    { 0, eString },  //                          U+24BD
    { 0, eString },  //                          U+24BE
    { 0, eString },  //                          U+24BF
    { 0, eString },  //                          U+24C0
    { 0, eString },  //                          U+24C1
    { 0, eString },  //                          U+24C2
    { 0, eString },  //                          U+24C3
    { 0, eString },  //                          U+24C4
    { 0, eString },  //                          U+24C5
    { 0, eString },  //                          U+24C6
    { 0, eString },  //                          U+24C7
    { "S in circle", eString },  // old dictionary  U+24C8
    { 0, eString },  //                          U+24C9
    { 0, eString },  //                          U+24CA
    { 0, eString },  //                          U+24CB
    { 0, eString },  //                          U+24CC
    { 0, eString },  //                          U+24CD
    { 0, eString },  //                          U+24CE
    { 0, eString },  //                          U+24CF
    { 0, eString },  //                          U+24D0
    { 0, eString },  //                          U+24D1
    { 0, eString },  //                          U+24D2
    { 0, eString },  //                          U+24D3
    { 0, eString },  //                          U+24D4
    { 0, eString },  //                          U+24D5
    { 0, eString },  //                          U+24D6
    { 0, eString },  //                          U+24D7
    { 0, eString },  //                          U+24D8
    { 0, eString },  //                          U+24D9
    { 0, eString },  //                          U+24DA
    { 0, eString },  //                          U+24DB
    { 0, eString },  //                          U+24DC
    { 0, eString },  //                          U+24DD
    { 0, eString },  //                          U+24DE
    { 0, eString },  //                          U+24DF
    { 0, eString },  //                          U+24E0
    { 0, eString },  //                          U+24E1
    { 0, eString },  //                          U+24E2
    { 0, eString },  //                          U+24E3
    { 0, eString },  //                          U+24E4
    { 0, eString },  //                          U+24E5
    { 0, eString },  //                          U+24E6
    { 0, eString },  //                          U+24E7
    { 0, eString },  //                          U+24E8
    { 0, eString },  //                          U+24E9
    { 0, eString },  //                          U+24EA
    { 0, eString },  //                          U+24EB
    { 0, eString },  //                          U+24EC
    { 0, eString },  //                          U+24ED
    { 0, eString },  //                          U+24EE
    { 0, eString },  //                          U+24EF
    { 0, eString },  //                          U+24F0
    { 0, eString },  //                          U+24F1
    { 0, eString },  //                          U+24F2
    { 0, eString },  //                          U+24F3
    { 0, eString },  //                          U+24F4
    { 0, eString },  //                          U+24F5
    { 0, eString },  //                          U+24F6
    { 0, eString },  //                          U+24F7
    { 0, eString },  //                          U+24F8
    { 0, eString },  //                          U+24F9
    { 0, eString },  //                          U+24FA
    { 0, eString },  //                          U+24FB
    { 0, eString },  //                          U+24FC
    { 0, eString },  //                          U+24FD
    { 0, eString },  //                          U+24FE
    { 0, eString },  //                          U+24FF
};

/*
 * ==========================================================================
 * $Log$
 * Revision 1.1  2004/05/06 18:21:25  gouriano
 * Imported from pubmed/xmldb
 *
 * ==========================================================================
 */
