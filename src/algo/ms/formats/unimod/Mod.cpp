/* $Id$
 * ===========================================================================
 *
 *                            PUBLIC DOMAIN NOTICE
 *               National Center for Biotechnology Information
 *
 *  This software/database is a "United States Government Work" under the
 *  terms of the United States Copyright Act.  It was written as part of
 *  the author's official duties as a United States Government employee and
 *  thus cannot be copyrighted.  This software/database is freely available
 *  to the public for use. The National Library of Medicine and the U.S.
 *  Government have not placed any restriction on its use or reproduction.
 *
 *  Although all reasonable efforts have been taken to ensure the accuracy
 *  and reliability of the software and data, the NLM and the U.S.
 *  Government do not and cannot warrant the performance or results that
 *  may be obtained by using this software or data. The NLM and the U.S.
 *  Government disclaim all warranties, express or implied, including
 *  warranties of performance, merchantability or fitness for any particular
 *  purpose.
 *
 *  Please cite the author in any work or product based on this material.
 *
 * ===========================================================================
 *
 * Author:  Douglas Slotta
 *
 * File Description:
 *   .......
 *
 * Remark:
 *   This code was originally generated by application DATATOOL
 *   using the following specifications:
 *   'unimod.xsd'.
 */

// standard includes
#include <ncbi_pch.hpp>
#include <util/dictionary_util.hpp>

// generated includes
#include <algo/ms/formats/unimod/Mod.hpp>
#include <algo/ms/formats/unimod/Specificity.hpp>

// generated classes

BEGIN_NCBI_SCOPE

BEGIN_objects_SCOPE // namespace ncbi::objects::

BEGIN_unimod_SCOPE // namespace ncbi::objects::unimod::

bool CMod::isResidueSubset(const string residues) {
    vector<char> dis, dat;
    
    ITERATE(TSpecificity, iSpec, GetSpecificity()) {
        if ((*iSpec)->GetAttlist().GetSite().length() == 1) {
            dis.push_back((*iSpec)->GetAttlist().GetSite()[0]);
        }
    }
    for (size_t i=0; i<residues.length(); i++) {
        dat.push_back(residues[i]);
    }
    sort(dis.begin(), dis.end());
    sort(dat.begin(), dat.end());
    return includes(dis.begin(), dis.end(), dat.begin(), dat.end());
}

size_t CMod::name_distance(string name) {
    size_t eOne, eTwo;
    
    eOne = CDictionaryUtil::GetEditDistance(name, GetAttlist().GetTitle());
    eTwo = CDictionaryUtil::GetEditDistance(name, GetAttlist().GetFull_name());

    if (eOne < eTwo) return eOne;
    return eTwo;
}

// destructor
CMod::~CMod(void)
{
}

END_unimod_SCOPE // namespace ncbi::objects::unimod::

END_objects_SCOPE // namespace ncbi::objects::

END_NCBI_SCOPE

/* Original file checksum: lines: 61, chars: 1820, CRC32: 3d7c5eb1 */
