
enum class eTestNames
{
    ALL_SEQS_CIRCULAR,
    ALL_SEQS_SHORTER_THAN_20kb,
    AMPLIFIED_PRIMERS_NO_ENVIRONMENTAL_SAMPLE,
    ASSEMBLY_NAME_IN_GENOME_ASSEMBLY,
    ATCC_CULTURE_CONFLICT,
    AUTODEF_USER_OBJECT,
    BACTERIAL_JOINED_FEATURES_NO_EXCEPTION,
    BACTERIAL_PARTIAL_NONEXTENDABLE_EXCEPTION,
    BACTERIAL_PARTIAL_NONEXTENDABLE_PROBLEMS,
    BACTERIA_SHOULD_NOT_HAVE_ISOLATE,
    BACTERIA_SHOULD_NOT_HAVE_MRNA,
    BAD_BACTERIAL_GENE_NAME,
    BAD_BGPIPE_QUALS,
    BAD_GENE_NAME,
    BAD_GENE_STRAND,
    BAD_LOCUS_TAG_FORMAT,
    BAD_MRNA_QUAL,
    BIOMATERIAL_TAXNAME_MISMATCH,
    BIOPROJECT_ID,
    CDS_HAS_CDD_XREF,
    CDS_HAS_NEW_EXCEPTION,
    CDS_HAS_NO_ADJACENT_TRNA,
    CDS_TRNA_OVERLAP,
    CDS_WITHOUT_MRNA,
    CHECK_AUTHORITY,
    CHECK_AUTH_CAPS,
    CHECK_AUTH_NAME,
    CHECK_RNA_PRODUCTS_AND_COMMENTS,
    CHROMOSOME_PRESENT,
    CITSUBAFFIL_CONFLICT,
    CITSUB_AFFIL_DUP_TEXT,
    COMMENT_PRESENT,
    CONSORTIUM,
    CONTAINED_CDS,
    COUNTRY_COLON,
    COUNT_NUCLEOTIDES,
    COUNT_PROTEINS,
    COUNT_RRNAS,
    COUNT_TRNAS,
    COUNT_UNVERIFIED,
    CULTURE_TAXNAME_MISMATCH,
    DEFLINE_ON_SET,
    DEFLINE_PRESENT,
    DEPRECATED,
    DIVISION_CODE_CONFLICTS,
    DUPLICATE_LOCUS_TAGS,
    DUPLICATE_PRIMER_SET,
    DUP_DEFLINE,
    DUP_GENES_OPPOSITE_STRANDS,
    DUP_SRC_QUAL,
    EC_NUMBER_ON_UNKNOWN_PROTEIN,
    END_COLON_IN_COUNTRY,
    EUKARYOTE_SHOULD_HAVE_MRNA,
    EXON_INTRON_CONFLICT,
    EXON_ON_MRNA,
    EXTERNAL_REFERENCE,
    EXTRA_GENES,
    FEATURE_COUNT,
    FEATURE_LIST,
    FEATURE_LOCATION_CONFLICT,
    FEATURE_MOLTYPE_MISMATCH,
    FIND_BADLEN_TRNAS,
    FIND_OVERLAPPED_GENES,
    FIND_STRAND_TRNAS,
    FLATFILE_FIND,
    GAPS,
    GENE_LOCUS_MISSING,
    GENE_MISC_IGS_OVERLAP,
    GENE_PARTIAL_CONFLICT,
    GENE_PRODUCT_CONFLICT,
    GENE_WITH_MULTIPLE_RRNAS,
    GENOMIC_MRNA,
    HAS_PROJECT_ID,
    HUMAN_HOST,
    INCONSISTENT_BIOSOURCE,
    INCONSISTENT_DBLINK,
    INCONSISTENT_LOCUS_TAG_PREFIX,
    INCONSISTENT_MOLINFO_TECH,
    INCONSISTENT_MOLTYPES,
    INCONSISTENT_PROTEIN_ID,
    INCONSISTENT_STRUCTURED_COMMENTS,
    INFLUENZA_DATE_MISMATCH,
    INFLUENZA_QUALS,
    INFLUENZA_SEROTYPE,
    INFLUENZA_SEROTYPE_FORMAT,
    INTERNAL_TRANSCRIBED_SPACER_RRNA,
    JOINED_FEATURES,
    LONG_NO_ANNOTATION,
    LOW_QUALITY_REGION,
    MAG_MISSING_ISOLATE,
    MAG_SHOULD_NOT_HAVE_STRAIN,
    MAP_CHROMOSOME_CONFLICT,
    METAGENOME_SOURCE,
    METAGENOMIC,
    MICROSATELLITE_REPEAT_TYPE,
    MISC_FEATURE_WITH_PRODUCT_QUAL,
    MISMATCHED_COMMENTS,
    MISSING_AFFIL,
    MISSING_DEFLINES,
    MISSING_GENES,
    MISSING_LOCUS_TAGS,
    MISSING_PRIMER,
    MISSING_PROJECT,
    MISSING_PROTEIN_ID,
    MISSING_STRUCTURED_COMMENT,
    MISSING_VIRAL_QUALS,
    MITOCHONDRION_REQUIRED,
    MITO_RRNA,
    MRNA_ON_WRONG_SEQUENCE_TYPE,
    MRNA_OVERLAPPING_PSEUDO_GENE,
    MRNA_SEQUENCE_MINUS_STRAND_FEATURES,
    MRNA_SHOULD_HAVE_PROTEIN_TRANSCRIPT_IDS,
    MULTIPLE_CDS_ON_MRNA,
    MULTIPLE_CULTURE_COLLECTION,
    MULTIPLE_QUALS,
    MULTISRC,
    NONWGS_SETS_PRESENT,
    NON_GENE_LOCUS_TAG,
    NON_RETROVIRIDAE_PROVIRAL,
    NOTE_NO_TRANSL,
    NO_ANNOTATION,
    NO_LOCUS_TAGS,
    NO_PRODUCT_STRING,
    N_RUNS,
    N_RUNS_14,
    ORDERED_LOCATION,
    ORGANELLE_ITS,
    ORGANELLE_NOT_GENOMIC,
    ORGANELLE_PRESENT,
    ORGANELLE_PRODUCTS,
    ORG_TRNAS,
    OVERLAPPING_CDS,
    OVERLAPPING_GENES,
    OVERLAPPING_RRNAS,
    PARTIAL_CDS_COMPLETE_SEQUENCE,
    PARTIAL_PROBLEMS,
    PERCENT_N,
    POSSIBLE_LINKER,
    PROTEIN_NAMES,
    PSEUDO_MISMATCH,
    QUALITY_SCORES,
    RBS_WITHOUT_GENE,
    REQUIRED_CLONE,
    REQUIRED_STRAIN,
    RETROVIRIDAE_DNA,
    RIBOSOMAL_SLIPPAGE,
    RNA_CDS_OVERLAP,
    RNA_NO_PRODUCT,
    RNA_PROVIRAL,
    RRNA_NAME_CONFLICTS,
    SARS_QUALS,
    SEGSETS_PRESENT,
    SEQUENCE_READ_ARCHIVE,
    SEQ_SHORTER_THAN_200bp,
    SEQ_SHORTER_THAN_50bp,
    SHORT_INTRON,
    SHORT_LNCRNA,
    SHORT_PROT_SEQUENCES,
    SHORT_RRNA,
    SHOW_HYPOTHETICAL_CDS_HAVING_GENE_NAME,
    SHOW_TRANSL_EXCEPT,
    SMALL_GENOME_SET_PROBLEM,
    SOURCE_QUALS,
    SPECVOUCHER_TAXNAME_MISMATCH,
    SP_NOT_UNCULTURED,
    STRAIN_CULTURE_COLLECTION_MISMATCH,
    STRAIN_TAXNAME_MISMATCH,
    SUBMITBLOCK_CONFLICT,
    SUPERFLUOUS_GENE,
    SUSPECT_PHRASES,
    SUSPECT_PRODUCT_NAMES,
    SUSPECT_RRNA_PRODUCTS,
    SUSPICIOUS_NOTE_TEXT,
    SUSPICIOUS_SEQUENCE_ID,
    SWITCH_STRUCTURED_COMMENT_PREFIX,
    TAXNAME_NOT_IN_DEFLINE,
    TAX_LOOKUP_MISMATCH,
    TAX_LOOKUP_MISSING,
    TEN_PERCENTN,
    TERMINAL_NS,
    TITLE_AUTHOR_CONFLICT,
    TITLE_ENDS_WITH_SEQUENCE,
    TRANSL_NO_NOTE,
    TRANSL_TOO_LONG,
    TRINOMIAL_SHOULD_HAVE_QUALIFIER,
    UNCULTURED_NOTES,
    UNNECESSARY_ENVIRONMENTAL,
    UNNECESSARY_VIRUS_GENE,
    UNPUB_PUB_WITHOUT_TITLE,
    UNUSUAL_ITS,
    UNUSUAL_MISC_RNA,
    UNUSUAL_NT,
    UNWANTED_SET_WRAPPER,
    UNWANTED_SPACER,
    USA_STATE,
    VERY_LONG_NO_ANNOTATION,
    ZERO_BASECOUNT,
    _CDS_TRNA_OVERLAP,
    _SUSPECT_PRODUCT_NAMES,
    max_test_names,
    notset,
};

#define DISC_AUTOFIX_TESTNAMES \
    eTestNames::AMPLIFIED_PRIMERS_NO_ENVIRONMENTAL_SAMPLE,  \
    eTestNames::ATCC_CULTURE_CONFLICT,  \
    eTestNames::BACTERIAL_PARTIAL_NONEXTENDABLE_PROBLEMS,  \
    eTestNames::BAD_BACTERIAL_GENE_NAME,  \
    eTestNames::BAD_GENE_NAME,  \
    eTestNames::CDS_WITHOUT_MRNA,  \
    eTestNames::CHECK_AUTH_CAPS,  \
    eTestNames::CITSUB_AFFIL_DUP_TEXT,  \
    eTestNames::CONSORTIUM,  \
    eTestNames::CONTAINED_CDS,  \
    eTestNames::COUNTRY_COLON,  \
    eTestNames::DEPRECATED,  \
    eTestNames::EC_NUMBER_ON_UNKNOWN_PROTEIN,  \
    eTestNames::END_COLON_IN_COUNTRY,  \
    eTestNames::EXON_ON_MRNA,  \
    eTestNames::FEATURE_MOLTYPE_MISMATCH,  \
    eTestNames::FLATFILE_FIND,  \
    eTestNames::GENE_LOCUS_MISSING,  \
    eTestNames::HUMAN_HOST,  \
    eTestNames::MICROSATELLITE_REPEAT_TYPE,  \
    eTestNames::MISMATCHED_COMMENTS,  \
    eTestNames::MITOCHONDRION_REQUIRED,  \
    eTestNames::MRNA_OVERLAPPING_PSEUDO_GENE,  \
    eTestNames::MRNA_SEQUENCE_MINUS_STRAND_FEATURES,  \
    eTestNames::NONWGS_SETS_PRESENT,  \
    eTestNames::ORDERED_LOCATION,  \
    eTestNames::ORGANELLE_PRODUCTS,  \
    eTestNames::OVERLAPPING_CDS,  \
    eTestNames::PARTIAL_PROBLEMS,  \
    eTestNames::POSSIBLE_LINKER,  \
    eTestNames::PSEUDO_MISMATCH,  \
    eTestNames::RETROVIRIDAE_DNA,  \
    eTestNames::RRNA_NAME_CONFLICTS,  \
    eTestNames::SEQ_SHORTER_THAN_200bp,  \
    eTestNames::SHORT_INTRON,  \
    eTestNames::SHOW_HYPOTHETICAL_CDS_HAVING_GENE_NAME,  \
    eTestNames::SOURCE_QUALS,  \
    eTestNames::SUSPECT_PRODUCT_NAMES,  \
    eTestNames::SWITCH_STRUCTURED_COMMENT_PREFIX,  \
    eTestNames::USA_STATE,  \
    eTestNames::_CDS_TRNA_OVERLAP

